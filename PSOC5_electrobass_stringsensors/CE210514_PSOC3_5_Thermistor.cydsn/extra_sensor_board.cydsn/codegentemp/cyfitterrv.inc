;
; File Name: cyfitterrv.inc
; 
; PSoC Creator  4.4
;
; Description:
; 
;
;-------------------------------------------------------------------------------
; Copyright (c) 2007-2020 Cypress Semiconductor.  All rights reserved.
; You may use this file only in accordance with the license, terms, conditions, 
; disclaimers, and limitations in the end user license agreement accompanying 
; the software package with which this file was provided.
;-------------------------------------------------------------------------------

    IF :LNOT::DEF:INCLUDED_CYFITTERRV_INC
INCLUDED_CYFITTERRV_INC EQU 1
    GET cydevicerv.inc
    GET cydevicerv_trm.inc

; I2CS
I2CS_I2C_FF__ADR EQU CYREG_I2C_ADR
I2CS_I2C_FF__CFG EQU CYREG_I2C_CFG
I2CS_I2C_FF__CLK_DIV1 EQU CYREG_I2C_CLK_DIV1
I2CS_I2C_FF__CLK_DIV2 EQU CYREG_I2C_CLK_DIV2
I2CS_I2C_FF__CSR EQU CYREG_I2C_CSR
I2CS_I2C_FF__D EQU CYREG_I2C_D
I2CS_I2C_FF__MCSR EQU CYREG_I2C_MCSR
I2CS_I2C_FF__PM_ACT_CFG EQU CYREG_PM_ACT_CFG5
I2CS_I2C_FF__PM_ACT_MSK EQU 0x04
I2CS_I2C_FF__PM_STBY_CFG EQU CYREG_PM_STBY_CFG5
I2CS_I2C_FF__PM_STBY_MSK EQU 0x04
I2CS_I2C_FF__TMOUT_CFG0 EQU CYREG_I2C_TMOUT_CFG0
I2CS_I2C_FF__TMOUT_CFG1 EQU CYREG_I2C_TMOUT_CFG1
I2CS_I2C_FF__TMOUT_CSR EQU CYREG_I2C_TMOUT_CSR
I2CS_I2C_FF__TMOUT_SR EQU CYREG_I2C_TMOUT_SR
I2CS_I2C_FF__XCFG EQU CYREG_I2C_XCFG
I2CS_I2C_IRQ__INTC_CLR_EN_REG EQU CYREG_NVIC_CLRENA0
I2CS_I2C_IRQ__INTC_CLR_PD_REG EQU CYREG_NVIC_CLRPEND0
I2CS_I2C_IRQ__INTC_MASK EQU 0x8000
I2CS_I2C_IRQ__INTC_NUMBER EQU 15
I2CS_I2C_IRQ__INTC_PRIOR_NUM EQU 7
I2CS_I2C_IRQ__INTC_PRIOR_REG EQU CYREG_NVIC_PRI_15
I2CS_I2C_IRQ__INTC_SET_EN_REG EQU CYREG_NVIC_SETENA0
I2CS_I2C_IRQ__INTC_SET_PD_REG EQU CYREG_NVIC_SETPEND0

; ADC_1
ADC_1_Bypass_P03__0__INTTYPE EQU CYREG_PICU0_INTTYPE3
ADC_1_Bypass_P03__0__MASK EQU 0x08
ADC_1_Bypass_P03__0__PC EQU CYREG_PRT0_PC3
ADC_1_Bypass_P03__0__PORT EQU 0
ADC_1_Bypass_P03__0__SHIFT EQU 3
ADC_1_Bypass_P03__AG EQU CYREG_PRT0_AG
ADC_1_Bypass_P03__AMUX EQU CYREG_PRT0_AMUX
ADC_1_Bypass_P03__BIE EQU CYREG_PRT0_BIE
ADC_1_Bypass_P03__BIT_MASK EQU CYREG_PRT0_BIT_MASK
ADC_1_Bypass_P03__BYP EQU CYREG_PRT0_BYP
ADC_1_Bypass_P03__CTL EQU CYREG_PRT0_CTL
ADC_1_Bypass_P03__DM0 EQU CYREG_PRT0_DM0
ADC_1_Bypass_P03__DM1 EQU CYREG_PRT0_DM1
ADC_1_Bypass_P03__DM2 EQU CYREG_PRT0_DM2
ADC_1_Bypass_P03__DR EQU CYREG_PRT0_DR
ADC_1_Bypass_P03__INP_DIS EQU CYREG_PRT0_INP_DIS
ADC_1_Bypass_P03__INTTYPE_BASE EQU CYDEV_PICU_INTTYPE_PICU0_BASE
ADC_1_Bypass_P03__LCD_COM_SEG EQU CYREG_PRT0_LCD_COM_SEG
ADC_1_Bypass_P03__LCD_EN EQU CYREG_PRT0_LCD_EN
ADC_1_Bypass_P03__MASK EQU 0x08
ADC_1_Bypass_P03__PORT EQU 0
ADC_1_Bypass_P03__PRT EQU CYREG_PRT0_PRT
ADC_1_Bypass_P03__PRTDSI__CAPS_SEL EQU CYREG_PRT0_CAPS_SEL
ADC_1_Bypass_P03__PRTDSI__DBL_SYNC_IN EQU CYREG_PRT0_DBL_SYNC_IN
ADC_1_Bypass_P03__PRTDSI__OE_SEL0 EQU CYREG_PRT0_OE_SEL0
ADC_1_Bypass_P03__PRTDSI__OE_SEL1 EQU CYREG_PRT0_OE_SEL1
ADC_1_Bypass_P03__PRTDSI__OUT_SEL0 EQU CYREG_PRT0_OUT_SEL0
ADC_1_Bypass_P03__PRTDSI__OUT_SEL1 EQU CYREG_PRT0_OUT_SEL1
ADC_1_Bypass_P03__PRTDSI__SYNC_OUT EQU CYREG_PRT0_SYNC_OUT
ADC_1_Bypass_P03__PS EQU CYREG_PRT0_PS
ADC_1_Bypass_P03__SHIFT EQU 3
ADC_1_Bypass_P03__SLW EQU CYREG_PRT0_SLW
ADC_1_DEC__COHER EQU CYREG_DEC_COHER
ADC_1_DEC__CR EQU CYREG_DEC_CR
ADC_1_DEC__DR1 EQU CYREG_DEC_DR1
ADC_1_DEC__DR2 EQU CYREG_DEC_DR2
ADC_1_DEC__DR2H EQU CYREG_DEC_DR2H
ADC_1_DEC__GCOR EQU CYREG_DEC_GCOR
ADC_1_DEC__GCORH EQU CYREG_DEC_GCORH
ADC_1_DEC__GVAL EQU CYREG_DEC_GVAL
ADC_1_DEC__OCOR EQU CYREG_DEC_OCOR
ADC_1_DEC__OCORH EQU CYREG_DEC_OCORH
ADC_1_DEC__OCORM EQU CYREG_DEC_OCORM
ADC_1_DEC__OUTSAMP EQU CYREG_DEC_OUTSAMP
ADC_1_DEC__OUTSAMPH EQU CYREG_DEC_OUTSAMPH
ADC_1_DEC__OUTSAMPM EQU CYREG_DEC_OUTSAMPM
ADC_1_DEC__OUTSAMPS EQU CYREG_DEC_OUTSAMPS
ADC_1_DEC__PM_ACT_CFG EQU CYREG_PM_ACT_CFG10
ADC_1_DEC__PM_ACT_MSK EQU 0x01
ADC_1_DEC__PM_STBY_CFG EQU CYREG_PM_STBY_CFG10
ADC_1_DEC__PM_STBY_MSK EQU 0x01
ADC_1_DEC__SHIFT1 EQU CYREG_DEC_SHIFT1
ADC_1_DEC__SHIFT2 EQU CYREG_DEC_SHIFT2
ADC_1_DEC__SR EQU CYREG_DEC_SR
ADC_1_DEC__TRIM__M1 EQU CYREG_FLSHID_CUST_TABLES_DEC_M1
ADC_1_DEC__TRIM__M2 EQU CYREG_FLSHID_CUST_TABLES_DEC_M2
ADC_1_DEC__TRIM__M3 EQU CYREG_FLSHID_CUST_TABLES_DEC_M3
ADC_1_DEC__TRIM__M4 EQU CYREG_FLSHID_CUST_TABLES_DEC_M4
ADC_1_DEC__TRIM__M5 EQU CYREG_FLSHID_CUST_TABLES_DEC_M5
ADC_1_DEC__TRIM__M6 EQU CYREG_FLSHID_CUST_TABLES_DEC_M6
ADC_1_DEC__TRIM__M7 EQU CYREG_FLSHID_CUST_TABLES_DEC_M7
ADC_1_DEC__TRIM__M8 EQU CYREG_FLSHID_CUST_TABLES_DEC_M8
ADC_1_DSM__BUF0 EQU CYREG_DSM0_BUF0
ADC_1_DSM__BUF1 EQU CYREG_DSM0_BUF1
ADC_1_DSM__BUF2 EQU CYREG_DSM0_BUF2
ADC_1_DSM__BUF3 EQU CYREG_DSM0_BUF3
ADC_1_DSM__CLK EQU CYREG_DSM0_CLK
ADC_1_DSM__CR0 EQU CYREG_DSM0_CR0
ADC_1_DSM__CR1 EQU CYREG_DSM0_CR1
ADC_1_DSM__CR10 EQU CYREG_DSM0_CR10
ADC_1_DSM__CR11 EQU CYREG_DSM0_CR11
ADC_1_DSM__CR12 EQU CYREG_DSM0_CR12
ADC_1_DSM__CR13 EQU CYREG_DSM0_CR13
ADC_1_DSM__CR14 EQU CYREG_DSM0_CR14
ADC_1_DSM__CR15 EQU CYREG_DSM0_CR15
ADC_1_DSM__CR16 EQU CYREG_DSM0_CR16
ADC_1_DSM__CR17 EQU CYREG_DSM0_CR17
ADC_1_DSM__CR2 EQU CYREG_DSM0_CR2
ADC_1_DSM__CR3 EQU CYREG_DSM0_CR3
ADC_1_DSM__CR4 EQU CYREG_DSM0_CR4
ADC_1_DSM__CR5 EQU CYREG_DSM0_CR5
ADC_1_DSM__CR6 EQU CYREG_DSM0_CR6
ADC_1_DSM__CR7 EQU CYREG_DSM0_CR7
ADC_1_DSM__CR8 EQU CYREG_DSM0_CR8
ADC_1_DSM__CR9 EQU CYREG_DSM0_CR9
ADC_1_DSM__DEM0 EQU CYREG_DSM0_DEM0
ADC_1_DSM__DEM1 EQU CYREG_DSM0_DEM1
ADC_1_DSM__MISC EQU CYREG_DSM0_MISC
ADC_1_DSM__OUT0 EQU CYREG_DSM0_OUT0
ADC_1_DSM__OUT1 EQU CYREG_DSM0_OUT1
ADC_1_DSM__REF0 EQU CYREG_DSM0_REF0
ADC_1_DSM__REF1 EQU CYREG_DSM0_REF1
ADC_1_DSM__REF2 EQU CYREG_DSM0_REF2
ADC_1_DSM__REF3 EQU CYREG_DSM0_REF3
ADC_1_DSM__RSVD1 EQU CYREG_DSM0_RSVD1
ADC_1_DSM__SW0 EQU CYREG_DSM0_SW0
ADC_1_DSM__SW2 EQU CYREG_DSM0_SW2
ADC_1_DSM__SW3 EQU CYREG_DSM0_SW3
ADC_1_DSM__SW4 EQU CYREG_DSM0_SW4
ADC_1_DSM__SW6 EQU CYREG_DSM0_SW6
ADC_1_DSM__TR0 EQU CYREG_NPUMP_DSM_TR0
ADC_1_DSM__TST0 EQU CYREG_DSM0_TST0
ADC_1_DSM__TST1 EQU CYREG_DSM0_TST1
ADC_1_Ext_CP_Clk__CFG0 EQU CYREG_CLKDIST_DCFG0_CFG0
ADC_1_Ext_CP_Clk__CFG1 EQU CYREG_CLKDIST_DCFG0_CFG1
ADC_1_Ext_CP_Clk__CFG2 EQU CYREG_CLKDIST_DCFG0_CFG2
ADC_1_Ext_CP_Clk__CFG2_SRC_SEL_MASK EQU 0x07
ADC_1_Ext_CP_Clk__INDEX EQU 0x00
ADC_1_Ext_CP_Clk__PM_ACT_CFG EQU CYREG_PM_ACT_CFG2
ADC_1_Ext_CP_Clk__PM_ACT_MSK EQU 0x01
ADC_1_Ext_CP_Clk__PM_STBY_CFG EQU CYREG_PM_STBY_CFG2
ADC_1_Ext_CP_Clk__PM_STBY_MSK EQU 0x01
ADC_1_IRQ__INTC_CLR_EN_REG EQU CYREG_NVIC_CLRENA0
ADC_1_IRQ__INTC_CLR_PD_REG EQU CYREG_NVIC_CLRPEND0
ADC_1_IRQ__INTC_MASK EQU 0x20000000
ADC_1_IRQ__INTC_NUMBER EQU 29
ADC_1_IRQ__INTC_PRIOR_NUM EQU 7
ADC_1_IRQ__INTC_PRIOR_REG EQU CYREG_NVIC_PRI_29
ADC_1_IRQ__INTC_SET_EN_REG EQU CYREG_NVIC_SETENA0
ADC_1_IRQ__INTC_SET_PD_REG EQU CYREG_NVIC_SETPEND0
ADC_1_theACLK__CFG0 EQU CYREG_CLKDIST_ACFG0_CFG0
ADC_1_theACLK__CFG1 EQU CYREG_CLKDIST_ACFG0_CFG1
ADC_1_theACLK__CFG2 EQU CYREG_CLKDIST_ACFG0_CFG2
ADC_1_theACLK__CFG2_SRC_SEL_MASK EQU 0x07
ADC_1_theACLK__CFG3 EQU CYREG_CLKDIST_ACFG0_CFG3
ADC_1_theACLK__CFG3_PHASE_DLY_MASK EQU 0x0F
ADC_1_theACLK__INDEX EQU 0x00
ADC_1_theACLK__PM_ACT_CFG EQU CYREG_PM_ACT_CFG1
ADC_1_theACLK__PM_ACT_MSK EQU 0x01
ADC_1_theACLK__PM_STBY_CFG EQU CYREG_PM_STBY_CFG1
ADC_1_theACLK__PM_STBY_MSK EQU 0x01

; MUX_0
MUX_0__0__INTTYPE EQU CYREG_PICU15_INTTYPE0
MUX_0__0__MASK EQU 0x01
MUX_0__0__PC EQU CYREG_IO_PC_PRT15_PC0
MUX_0__0__PORT EQU 15
MUX_0__0__SHIFT EQU 0
MUX_0__AG EQU CYREG_PRT15_AG
MUX_0__AMUX EQU CYREG_PRT15_AMUX
MUX_0__BIE EQU CYREG_PRT15_BIE
MUX_0__BIT_MASK EQU CYREG_PRT15_BIT_MASK
MUX_0__BYP EQU CYREG_PRT15_BYP
MUX_0__CTL EQU CYREG_PRT15_CTL
MUX_0__DM0 EQU CYREG_PRT15_DM0
MUX_0__DM1 EQU CYREG_PRT15_DM1
MUX_0__DM2 EQU CYREG_PRT15_DM2
MUX_0__DR EQU CYREG_PRT15_DR
MUX_0__INP_DIS EQU CYREG_PRT15_INP_DIS
MUX_0__INTTYPE_BASE EQU CYDEV_PICU_INTTYPE_PICU15_BASE
MUX_0__LCD_COM_SEG EQU CYREG_PRT15_LCD_COM_SEG
MUX_0__LCD_EN EQU CYREG_PRT15_LCD_EN
MUX_0__MASK EQU 0x01
MUX_0__PORT EQU 15
MUX_0__PRT EQU CYREG_PRT15_PRT
MUX_0__PRTDSI__CAPS_SEL EQU CYREG_PRT15_CAPS_SEL
MUX_0__PRTDSI__DBL_SYNC_IN EQU CYREG_PRT15_DBL_SYNC_IN
MUX_0__PRTDSI__OE_SEL0 EQU CYREG_PRT15_OE_SEL0
MUX_0__PRTDSI__OE_SEL1 EQU CYREG_PRT15_OE_SEL1
MUX_0__PRTDSI__OUT_SEL0 EQU CYREG_PRT15_OUT_SEL0
MUX_0__PRTDSI__OUT_SEL1 EQU CYREG_PRT15_OUT_SEL1
MUX_0__PRTDSI__SYNC_OUT EQU CYREG_PRT15_SYNC_OUT
MUX_0__PS EQU CYREG_PRT15_PS
MUX_0__SHIFT EQU 0
MUX_0__SLW EQU CYREG_PRT15_SLW

; MUX_1
MUX_1__0__INTTYPE EQU CYREG_PICU15_INTTYPE1
MUX_1__0__MASK EQU 0x02
MUX_1__0__PC EQU CYREG_IO_PC_PRT15_PC1
MUX_1__0__PORT EQU 15
MUX_1__0__SHIFT EQU 1
MUX_1__AG EQU CYREG_PRT15_AG
MUX_1__AMUX EQU CYREG_PRT15_AMUX
MUX_1__BIE EQU CYREG_PRT15_BIE
MUX_1__BIT_MASK EQU CYREG_PRT15_BIT_MASK
MUX_1__BYP EQU CYREG_PRT15_BYP
MUX_1__CTL EQU CYREG_PRT15_CTL
MUX_1__DM0 EQU CYREG_PRT15_DM0
MUX_1__DM1 EQU CYREG_PRT15_DM1
MUX_1__DM2 EQU CYREG_PRT15_DM2
MUX_1__DR EQU CYREG_PRT15_DR
MUX_1__INP_DIS EQU CYREG_PRT15_INP_DIS
MUX_1__INTTYPE_BASE EQU CYDEV_PICU_INTTYPE_PICU15_BASE
MUX_1__LCD_COM_SEG EQU CYREG_PRT15_LCD_COM_SEG
MUX_1__LCD_EN EQU CYREG_PRT15_LCD_EN
MUX_1__MASK EQU 0x02
MUX_1__PORT EQU 15
MUX_1__PRT EQU CYREG_PRT15_PRT
MUX_1__PRTDSI__CAPS_SEL EQU CYREG_PRT15_CAPS_SEL
MUX_1__PRTDSI__DBL_SYNC_IN EQU CYREG_PRT15_DBL_SYNC_IN
MUX_1__PRTDSI__OE_SEL0 EQU CYREG_PRT15_OE_SEL0
MUX_1__PRTDSI__OE_SEL1 EQU CYREG_PRT15_OE_SEL1
MUX_1__PRTDSI__OUT_SEL0 EQU CYREG_PRT15_OUT_SEL0
MUX_1__PRTDSI__OUT_SEL1 EQU CYREG_PRT15_OUT_SEL1
MUX_1__PRTDSI__SYNC_OUT EQU CYREG_PRT15_SYNC_OUT
MUX_1__PS EQU CYREG_PRT15_PS
MUX_1__SHIFT EQU 1
MUX_1__SLW EQU CYREG_PRT15_SLW

; Pin_1
Pin_1__0__INTTYPE EQU CYREG_PICU2_INTTYPE7
Pin_1__0__MASK EQU 0x80
Pin_1__0__PC EQU CYREG_PRT2_PC7
Pin_1__0__PORT EQU 2
Pin_1__0__SHIFT EQU 7
Pin_1__AG EQU CYREG_PRT2_AG
Pin_1__AMUX EQU CYREG_PRT2_AMUX
Pin_1__BIE EQU CYREG_PRT2_BIE
Pin_1__BIT_MASK EQU CYREG_PRT2_BIT_MASK
Pin_1__BYP EQU CYREG_PRT2_BYP
Pin_1__CTL EQU CYREG_PRT2_CTL
Pin_1__DM0 EQU CYREG_PRT2_DM0
Pin_1__DM1 EQU CYREG_PRT2_DM1
Pin_1__DM2 EQU CYREG_PRT2_DM2
Pin_1__DR EQU CYREG_PRT2_DR
Pin_1__INP_DIS EQU CYREG_PRT2_INP_DIS
Pin_1__INTTYPE_BASE EQU CYDEV_PICU_INTTYPE_PICU2_BASE
Pin_1__LCD_COM_SEG EQU CYREG_PRT2_LCD_COM_SEG
Pin_1__LCD_EN EQU CYREG_PRT2_LCD_EN
Pin_1__MASK EQU 0x80
Pin_1__PORT EQU 2
Pin_1__PRT EQU CYREG_PRT2_PRT
Pin_1__PRTDSI__CAPS_SEL EQU CYREG_PRT2_CAPS_SEL
Pin_1__PRTDSI__DBL_SYNC_IN EQU CYREG_PRT2_DBL_SYNC_IN
Pin_1__PRTDSI__OE_SEL0 EQU CYREG_PRT2_OE_SEL0
Pin_1__PRTDSI__OE_SEL1 EQU CYREG_PRT2_OE_SEL1
Pin_1__PRTDSI__OUT_SEL0 EQU CYREG_PRT2_OUT_SEL0
Pin_1__PRTDSI__OUT_SEL1 EQU CYREG_PRT2_OUT_SEL1
Pin_1__PRTDSI__SYNC_OUT EQU CYREG_PRT2_SYNC_OUT
Pin_1__PS EQU CYREG_PRT2_PS
Pin_1__SHIFT EQU 7
Pin_1__SLW EQU CYREG_PRT2_SLW

; Pin_2
Pin_2__0__INTTYPE EQU CYREG_PICU2_INTTYPE6
Pin_2__0__MASK EQU 0x40
Pin_2__0__PC EQU CYREG_PRT2_PC6
Pin_2__0__PORT EQU 2
Pin_2__0__SHIFT EQU 6
Pin_2__AG EQU CYREG_PRT2_AG
Pin_2__AMUX EQU CYREG_PRT2_AMUX
Pin_2__BIE EQU CYREG_PRT2_BIE
Pin_2__BIT_MASK EQU CYREG_PRT2_BIT_MASK
Pin_2__BYP EQU CYREG_PRT2_BYP
Pin_2__CTL EQU CYREG_PRT2_CTL
Pin_2__DM0 EQU CYREG_PRT2_DM0
Pin_2__DM1 EQU CYREG_PRT2_DM1
Pin_2__DM2 EQU CYREG_PRT2_DM2
Pin_2__DR EQU CYREG_PRT2_DR
Pin_2__INP_DIS EQU CYREG_PRT2_INP_DIS
Pin_2__INTTYPE_BASE EQU CYDEV_PICU_INTTYPE_PICU2_BASE
Pin_2__LCD_COM_SEG EQU CYREG_PRT2_LCD_COM_SEG
Pin_2__LCD_EN EQU CYREG_PRT2_LCD_EN
Pin_2__MASK EQU 0x40
Pin_2__PORT EQU 2
Pin_2__PRT EQU CYREG_PRT2_PRT
Pin_2__PRTDSI__CAPS_SEL EQU CYREG_PRT2_CAPS_SEL
Pin_2__PRTDSI__DBL_SYNC_IN EQU CYREG_PRT2_DBL_SYNC_IN
Pin_2__PRTDSI__OE_SEL0 EQU CYREG_PRT2_OE_SEL0
Pin_2__PRTDSI__OE_SEL1 EQU CYREG_PRT2_OE_SEL1
Pin_2__PRTDSI__OUT_SEL0 EQU CYREG_PRT2_OUT_SEL0
Pin_2__PRTDSI__OUT_SEL1 EQU CYREG_PRT2_OUT_SEL1
Pin_2__PRTDSI__SYNC_OUT EQU CYREG_PRT2_SYNC_OUT
Pin_2__PS EQU CYREG_PRT2_PS
Pin_2__SHIFT EQU 6
Pin_2__SLW EQU CYREG_PRT2_SLW

; SCL_1
SCL_1__0__INTTYPE EQU CYREG_PICU12_INTTYPE0
SCL_1__0__MASK EQU 0x01
SCL_1__0__PC EQU CYREG_PRT12_PC0
SCL_1__0__PORT EQU 12
SCL_1__0__SHIFT EQU 0
SCL_1__AG EQU CYREG_PRT12_AG
SCL_1__BIE EQU CYREG_PRT12_BIE
SCL_1__BIT_MASK EQU CYREG_PRT12_BIT_MASK
SCL_1__BYP EQU CYREG_PRT12_BYP
SCL_1__DM0 EQU CYREG_PRT12_DM0
SCL_1__DM1 EQU CYREG_PRT12_DM1
SCL_1__DM2 EQU CYREG_PRT12_DM2
SCL_1__DR EQU CYREG_PRT12_DR
SCL_1__INP_DIS EQU CYREG_PRT12_INP_DIS
SCL_1__INTTYPE_BASE EQU CYDEV_PICU_INTTYPE_PICU12_BASE
SCL_1__MASK EQU 0x01
SCL_1__PORT EQU 12
SCL_1__PRT EQU CYREG_PRT12_PRT
SCL_1__PRTDSI__DBL_SYNC_IN EQU CYREG_PRT12_DBL_SYNC_IN
SCL_1__PRTDSI__OE_SEL0 EQU CYREG_PRT12_OE_SEL0
SCL_1__PRTDSI__OE_SEL1 EQU CYREG_PRT12_OE_SEL1
SCL_1__PRTDSI__OUT_SEL0 EQU CYREG_PRT12_OUT_SEL0
SCL_1__PRTDSI__OUT_SEL1 EQU CYREG_PRT12_OUT_SEL1
SCL_1__PRTDSI__SYNC_OUT EQU CYREG_PRT12_SYNC_OUT
SCL_1__PS EQU CYREG_PRT12_PS
SCL_1__SHIFT EQU 0
SCL_1__SIO_CFG EQU CYREG_PRT12_SIO_CFG
SCL_1__SIO_DIFF EQU CYREG_PRT12_SIO_DIFF
SCL_1__SIO_HYST_EN EQU CYREG_PRT12_SIO_HYST_EN
SCL_1__SIO_REG_HIFREQ EQU CYREG_PRT12_SIO_REG_HIFREQ
SCL_1__SLW EQU CYREG_PRT12_SLW

; SDA_1
SDA_1__0__INTTYPE EQU CYREG_PICU12_INTTYPE1
SDA_1__0__MASK EQU 0x02
SDA_1__0__PC EQU CYREG_PRT12_PC1
SDA_1__0__PORT EQU 12
SDA_1__0__SHIFT EQU 1
SDA_1__AG EQU CYREG_PRT12_AG
SDA_1__BIE EQU CYREG_PRT12_BIE
SDA_1__BIT_MASK EQU CYREG_PRT12_BIT_MASK
SDA_1__BYP EQU CYREG_PRT12_BYP
SDA_1__DM0 EQU CYREG_PRT12_DM0
SDA_1__DM1 EQU CYREG_PRT12_DM1
SDA_1__DM2 EQU CYREG_PRT12_DM2
SDA_1__DR EQU CYREG_PRT12_DR
SDA_1__INP_DIS EQU CYREG_PRT12_INP_DIS
SDA_1__INTTYPE_BASE EQU CYDEV_PICU_INTTYPE_PICU12_BASE
SDA_1__MASK EQU 0x02
SDA_1__PORT EQU 12
SDA_1__PRT EQU CYREG_PRT12_PRT
SDA_1__PRTDSI__DBL_SYNC_IN EQU CYREG_PRT12_DBL_SYNC_IN
SDA_1__PRTDSI__OE_SEL0 EQU CYREG_PRT12_OE_SEL0
SDA_1__PRTDSI__OE_SEL1 EQU CYREG_PRT12_OE_SEL1
SDA_1__PRTDSI__OUT_SEL0 EQU CYREG_PRT12_OUT_SEL0
SDA_1__PRTDSI__OUT_SEL1 EQU CYREG_PRT12_OUT_SEL1
SDA_1__PRTDSI__SYNC_OUT EQU CYREG_PRT12_SYNC_OUT
SDA_1__PS EQU CYREG_PRT12_PS
SDA_1__SHIFT EQU 1
SDA_1__SIO_CFG EQU CYREG_PRT12_SIO_CFG
SDA_1__SIO_DIFF EQU CYREG_PRT12_SIO_DIFF
SDA_1__SIO_HYST_EN EQU CYREG_PRT12_SIO_HYST_EN
SDA_1__SIO_REG_HIFREQ EQU CYREG_PRT12_SIO_REG_HIFREQ
SDA_1__SLW EQU CYREG_PRT12_SLW

; MUX_En
MUX_En__0__INTTYPE EQU CYREG_PICU15_INTTYPE5
MUX_En__0__MASK EQU 0x20
MUX_En__0__PC EQU CYREG_IO_PC_PRT15_PC5
MUX_En__0__PORT EQU 15
MUX_En__0__SHIFT EQU 5
MUX_En__AG EQU CYREG_PRT15_AG
MUX_En__AMUX EQU CYREG_PRT15_AMUX
MUX_En__BIE EQU CYREG_PRT15_BIE
MUX_En__BIT_MASK EQU CYREG_PRT15_BIT_MASK
MUX_En__BYP EQU CYREG_PRT15_BYP
MUX_En__CTL EQU CYREG_PRT15_CTL
MUX_En__DM0 EQU CYREG_PRT15_DM0
MUX_En__DM1 EQU CYREG_PRT15_DM1
MUX_En__DM2 EQU CYREG_PRT15_DM2
MUX_En__DR EQU CYREG_PRT15_DR
MUX_En__INP_DIS EQU CYREG_PRT15_INP_DIS
MUX_En__INTTYPE_BASE EQU CYDEV_PICU_INTTYPE_PICU15_BASE
MUX_En__LCD_COM_SEG EQU CYREG_PRT15_LCD_COM_SEG
MUX_En__LCD_EN EQU CYREG_PRT15_LCD_EN
MUX_En__MASK EQU 0x20
MUX_En__PORT EQU 15
MUX_En__PRT EQU CYREG_PRT15_PRT
MUX_En__PRTDSI__CAPS_SEL EQU CYREG_PRT15_CAPS_SEL
MUX_En__PRTDSI__DBL_SYNC_IN EQU CYREG_PRT15_DBL_SYNC_IN
MUX_En__PRTDSI__OE_SEL0 EQU CYREG_PRT15_OE_SEL0
MUX_En__PRTDSI__OE_SEL1 EQU CYREG_PRT15_OE_SEL1
MUX_En__PRTDSI__OUT_SEL0 EQU CYREG_PRT15_OUT_SEL0
MUX_En__PRTDSI__OUT_SEL1 EQU CYREG_PRT15_OUT_SEL1
MUX_En__PRTDSI__SYNC_OUT EQU CYREG_PRT15_SYNC_OUT
MUX_En__PS EQU CYREG_PRT15_PS
MUX_En__SHIFT EQU 5
MUX_En__SLW EQU CYREG_PRT15_SLW

; string1
string1__0__INTTYPE EQU CYREG_PICU0_INTTYPE4
string1__0__MASK EQU 0x10
string1__0__PC EQU CYREG_PRT0_PC4
string1__0__PORT EQU 0
string1__0__SHIFT EQU 4
string1__AG EQU CYREG_PRT0_AG
string1__AMUX EQU CYREG_PRT0_AMUX
string1__BIE EQU CYREG_PRT0_BIE
string1__BIT_MASK EQU CYREG_PRT0_BIT_MASK
string1__BYP EQU CYREG_PRT0_BYP
string1__CTL EQU CYREG_PRT0_CTL
string1__DM0 EQU CYREG_PRT0_DM0
string1__DM1 EQU CYREG_PRT0_DM1
string1__DM2 EQU CYREG_PRT0_DM2
string1__DR EQU CYREG_PRT0_DR
string1__INP_DIS EQU CYREG_PRT0_INP_DIS
string1__INTTYPE_BASE EQU CYDEV_PICU_INTTYPE_PICU0_BASE
string1__LCD_COM_SEG EQU CYREG_PRT0_LCD_COM_SEG
string1__LCD_EN EQU CYREG_PRT0_LCD_EN
string1__MASK EQU 0x10
string1__PORT EQU 0
string1__PRT EQU CYREG_PRT0_PRT
string1__PRTDSI__CAPS_SEL EQU CYREG_PRT0_CAPS_SEL
string1__PRTDSI__DBL_SYNC_IN EQU CYREG_PRT0_DBL_SYNC_IN
string1__PRTDSI__OE_SEL0 EQU CYREG_PRT0_OE_SEL0
string1__PRTDSI__OE_SEL1 EQU CYREG_PRT0_OE_SEL1
string1__PRTDSI__OUT_SEL0 EQU CYREG_PRT0_OUT_SEL0
string1__PRTDSI__OUT_SEL1 EQU CYREG_PRT0_OUT_SEL1
string1__PRTDSI__SYNC_OUT EQU CYREG_PRT0_SYNC_OUT
string1__PS EQU CYREG_PRT0_PS
string1__SHIFT EQU 4
string1__SLW EQU CYREG_PRT0_SLW

; string2
string2__0__INTTYPE EQU CYREG_PICU0_INTTYPE5
string2__0__MASK EQU 0x20
string2__0__PC EQU CYREG_PRT0_PC5
string2__0__PORT EQU 0
string2__0__SHIFT EQU 5
string2__AG EQU CYREG_PRT0_AG
string2__AMUX EQU CYREG_PRT0_AMUX
string2__BIE EQU CYREG_PRT0_BIE
string2__BIT_MASK EQU CYREG_PRT0_BIT_MASK
string2__BYP EQU CYREG_PRT0_BYP
string2__CTL EQU CYREG_PRT0_CTL
string2__DM0 EQU CYREG_PRT0_DM0
string2__DM1 EQU CYREG_PRT0_DM1
string2__DM2 EQU CYREG_PRT0_DM2
string2__DR EQU CYREG_PRT0_DR
string2__INP_DIS EQU CYREG_PRT0_INP_DIS
string2__INTTYPE_BASE EQU CYDEV_PICU_INTTYPE_PICU0_BASE
string2__LCD_COM_SEG EQU CYREG_PRT0_LCD_COM_SEG
string2__LCD_EN EQU CYREG_PRT0_LCD_EN
string2__MASK EQU 0x20
string2__PORT EQU 0
string2__PRT EQU CYREG_PRT0_PRT
string2__PRTDSI__CAPS_SEL EQU CYREG_PRT0_CAPS_SEL
string2__PRTDSI__DBL_SYNC_IN EQU CYREG_PRT0_DBL_SYNC_IN
string2__PRTDSI__OE_SEL0 EQU CYREG_PRT0_OE_SEL0
string2__PRTDSI__OE_SEL1 EQU CYREG_PRT0_OE_SEL1
string2__PRTDSI__OUT_SEL0 EQU CYREG_PRT0_OUT_SEL0
string2__PRTDSI__OUT_SEL1 EQU CYREG_PRT0_OUT_SEL1
string2__PRTDSI__SYNC_OUT EQU CYREG_PRT0_SYNC_OUT
string2__PS EQU CYREG_PRT0_PS
string2__SHIFT EQU 5
string2__SLW EQU CYREG_PRT0_SLW

; string3
string3__0__INTTYPE EQU CYREG_PICU0_INTTYPE6
string3__0__MASK EQU 0x40
string3__0__PC EQU CYREG_PRT0_PC6
string3__0__PORT EQU 0
string3__0__SHIFT EQU 6
string3__AG EQU CYREG_PRT0_AG
string3__AMUX EQU CYREG_PRT0_AMUX
string3__BIE EQU CYREG_PRT0_BIE
string3__BIT_MASK EQU CYREG_PRT0_BIT_MASK
string3__BYP EQU CYREG_PRT0_BYP
string3__CTL EQU CYREG_PRT0_CTL
string3__DM0 EQU CYREG_PRT0_DM0
string3__DM1 EQU CYREG_PRT0_DM1
string3__DM2 EQU CYREG_PRT0_DM2
string3__DR EQU CYREG_PRT0_DR
string3__INP_DIS EQU CYREG_PRT0_INP_DIS
string3__INTTYPE_BASE EQU CYDEV_PICU_INTTYPE_PICU0_BASE
string3__LCD_COM_SEG EQU CYREG_PRT0_LCD_COM_SEG
string3__LCD_EN EQU CYREG_PRT0_LCD_EN
string3__MASK EQU 0x40
string3__PORT EQU 0
string3__PRT EQU CYREG_PRT0_PRT
string3__PRTDSI__CAPS_SEL EQU CYREG_PRT0_CAPS_SEL
string3__PRTDSI__DBL_SYNC_IN EQU CYREG_PRT0_DBL_SYNC_IN
string3__PRTDSI__OE_SEL0 EQU CYREG_PRT0_OE_SEL0
string3__PRTDSI__OE_SEL1 EQU CYREG_PRT0_OE_SEL1
string3__PRTDSI__OUT_SEL0 EQU CYREG_PRT0_OUT_SEL0
string3__PRTDSI__OUT_SEL1 EQU CYREG_PRT0_OUT_SEL1
string3__PRTDSI__SYNC_OUT EQU CYREG_PRT0_SYNC_OUT
string3__PS EQU CYREG_PRT0_PS
string3__SHIFT EQU 6
string3__SLW EQU CYREG_PRT0_SLW

; string4
string4__0__INTTYPE EQU CYREG_PICU0_INTTYPE7
string4__0__MASK EQU 0x80
string4__0__PC EQU CYREG_PRT0_PC7
string4__0__PORT EQU 0
string4__0__SHIFT EQU 7
string4__AG EQU CYREG_PRT0_AG
string4__AMUX EQU CYREG_PRT0_AMUX
string4__BIE EQU CYREG_PRT0_BIE
string4__BIT_MASK EQU CYREG_PRT0_BIT_MASK
string4__BYP EQU CYREG_PRT0_BYP
string4__CTL EQU CYREG_PRT0_CTL
string4__DM0 EQU CYREG_PRT0_DM0
string4__DM1 EQU CYREG_PRT0_DM1
string4__DM2 EQU CYREG_PRT0_DM2
string4__DR EQU CYREG_PRT0_DR
string4__INP_DIS EQU CYREG_PRT0_INP_DIS
string4__INTTYPE_BASE EQU CYDEV_PICU_INTTYPE_PICU0_BASE
string4__LCD_COM_SEG EQU CYREG_PRT0_LCD_COM_SEG
string4__LCD_EN EQU CYREG_PRT0_LCD_EN
string4__MASK EQU 0x80
string4__PORT EQU 0
string4__PRT EQU CYREG_PRT0_PRT
string4__PRTDSI__CAPS_SEL EQU CYREG_PRT0_CAPS_SEL
string4__PRTDSI__DBL_SYNC_IN EQU CYREG_PRT0_DBL_SYNC_IN
string4__PRTDSI__OE_SEL0 EQU CYREG_PRT0_OE_SEL0
string4__PRTDSI__OE_SEL1 EQU CYREG_PRT0_OE_SEL1
string4__PRTDSI__OUT_SEL0 EQU CYREG_PRT0_OUT_SEL0
string4__PRTDSI__OUT_SEL1 EQU CYREG_PRT0_OUT_SEL1
string4__PRTDSI__SYNC_OUT EQU CYREG_PRT0_SYNC_OUT
string4__PS EQU CYREG_PRT0_PS
string4__SHIFT EQU 7
string4__SLW EQU CYREG_PRT0_SLW

; vddaout
vddaout__0__INTTYPE EQU CYREG_PICU0_INTTYPE2
vddaout__0__MASK EQU 0x04
vddaout__0__PC EQU CYREG_PRT0_PC2
vddaout__0__PORT EQU 0
vddaout__0__SHIFT EQU 2
vddaout__AG EQU CYREG_PRT0_AG
vddaout__AMUX EQU CYREG_PRT0_AMUX
vddaout__BIE EQU CYREG_PRT0_BIE
vddaout__BIT_MASK EQU CYREG_PRT0_BIT_MASK
vddaout__BYP EQU CYREG_PRT0_BYP
vddaout__CTL EQU CYREG_PRT0_CTL
vddaout__DM0 EQU CYREG_PRT0_DM0
vddaout__DM1 EQU CYREG_PRT0_DM1
vddaout__DM2 EQU CYREG_PRT0_DM2
vddaout__DR EQU CYREG_PRT0_DR
vddaout__INP_DIS EQU CYREG_PRT0_INP_DIS
vddaout__INTTYPE_BASE EQU CYDEV_PICU_INTTYPE_PICU0_BASE
vddaout__LCD_COM_SEG EQU CYREG_PRT0_LCD_COM_SEG
vddaout__LCD_EN EQU CYREG_PRT0_LCD_EN
vddaout__MASK EQU 0x04
vddaout__PORT EQU 0
vddaout__PRT EQU CYREG_PRT0_PRT
vddaout__PRTDSI__CAPS_SEL EQU CYREG_PRT0_CAPS_SEL
vddaout__PRTDSI__DBL_SYNC_IN EQU CYREG_PRT0_DBL_SYNC_IN
vddaout__PRTDSI__OE_SEL0 EQU CYREG_PRT0_OE_SEL0
vddaout__PRTDSI__OE_SEL1 EQU CYREG_PRT0_OE_SEL1
vddaout__PRTDSI__OUT_SEL0 EQU CYREG_PRT0_OUT_SEL0
vddaout__PRTDSI__OUT_SEL1 EQU CYREG_PRT0_OUT_SEL1
vddaout__PRTDSI__SYNC_OUT EQU CYREG_PRT0_SYNC_OUT
vddaout__PS EQU CYREG_PRT0_PS
vddaout__SHIFT EQU 2
vddaout__SLW EQU CYREG_PRT0_SLW

; ResistorToVDDA
ResistorToVDDA__0__INTTYPE EQU CYREG_PICU0_INTTYPE1
ResistorToVDDA__0__MASK EQU 0x02
ResistorToVDDA__0__PC EQU CYREG_PRT0_PC1
ResistorToVDDA__0__PORT EQU 0
ResistorToVDDA__0__SHIFT EQU 1
ResistorToVDDA__AG EQU CYREG_PRT0_AG
ResistorToVDDA__AMUX EQU CYREG_PRT0_AMUX
ResistorToVDDA__BIE EQU CYREG_PRT0_BIE
ResistorToVDDA__BIT_MASK EQU CYREG_PRT0_BIT_MASK
ResistorToVDDA__BYP EQU CYREG_PRT0_BYP
ResistorToVDDA__CTL EQU CYREG_PRT0_CTL
ResistorToVDDA__DM0 EQU CYREG_PRT0_DM0
ResistorToVDDA__DM1 EQU CYREG_PRT0_DM1
ResistorToVDDA__DM2 EQU CYREG_PRT0_DM2
ResistorToVDDA__DR EQU CYREG_PRT0_DR
ResistorToVDDA__INP_DIS EQU CYREG_PRT0_INP_DIS
ResistorToVDDA__INTTYPE_BASE EQU CYDEV_PICU_INTTYPE_PICU0_BASE
ResistorToVDDA__LCD_COM_SEG EQU CYREG_PRT0_LCD_COM_SEG
ResistorToVDDA__LCD_EN EQU CYREG_PRT0_LCD_EN
ResistorToVDDA__MASK EQU 0x02
ResistorToVDDA__PORT EQU 0
ResistorToVDDA__PRT EQU CYREG_PRT0_PRT
ResistorToVDDA__PRTDSI__CAPS_SEL EQU CYREG_PRT0_CAPS_SEL
ResistorToVDDA__PRTDSI__DBL_SYNC_IN EQU CYREG_PRT0_DBL_SYNC_IN
ResistorToVDDA__PRTDSI__OE_SEL0 EQU CYREG_PRT0_OE_SEL0
ResistorToVDDA__PRTDSI__OE_SEL1 EQU CYREG_PRT0_OE_SEL1
ResistorToVDDA__PRTDSI__OUT_SEL0 EQU CYREG_PRT0_OUT_SEL0
ResistorToVDDA__PRTDSI__OUT_SEL1 EQU CYREG_PRT0_OUT_SEL1
ResistorToVDDA__PRTDSI__SYNC_OUT EQU CYREG_PRT0_SYNC_OUT
ResistorToVDDA__PS EQU CYREG_PRT0_PS
ResistorToVDDA__SHIFT EQU 1
ResistorToVDDA__SLW EQU CYREG_PRT0_SLW

; Miscellaneous
BCLK__BUS_CLK__HZ EQU 24000000
BCLK__BUS_CLK__KHZ EQU 24000
BCLK__BUS_CLK__MHZ EQU 24
CYDEV_CHIP_DIE_LEOPARD EQU 1
CYDEV_CHIP_DIE_PSOC4A EQU 26
CYDEV_CHIP_DIE_PSOC5LP EQU 2
CYDEV_CHIP_DIE_PSOC5TM EQU 3
CYDEV_CHIP_DIE_TMA4 EQU 4
CYDEV_CHIP_DIE_UNKNOWN EQU 0
CYDEV_CHIP_FAMILY_FM0P EQU 5
CYDEV_CHIP_FAMILY_FM3 EQU 6
CYDEV_CHIP_FAMILY_FM4 EQU 7
CYDEV_CHIP_FAMILY_PSOC3 EQU 1
CYDEV_CHIP_FAMILY_PSOC4 EQU 2
CYDEV_CHIP_FAMILY_PSOC5 EQU 3
CYDEV_CHIP_FAMILY_PSOC6 EQU 4
CYDEV_CHIP_FAMILY_UNKNOWN EQU 0
CYDEV_CHIP_FAMILY_USED EQU CYDEV_CHIP_FAMILY_PSOC5
CYDEV_CHIP_JTAG_ID EQU 0x2E161069
CYDEV_CHIP_MEMBER_3A EQU 1
CYDEV_CHIP_MEMBER_4A EQU 26
CYDEV_CHIP_MEMBER_4AA EQU 25
CYDEV_CHIP_MEMBER_4AB EQU 30
CYDEV_CHIP_MEMBER_4AC EQU 14
CYDEV_CHIP_MEMBER_4AD EQU 15
CYDEV_CHIP_MEMBER_4AE EQU 16
CYDEV_CHIP_MEMBER_4D EQU 20
CYDEV_CHIP_MEMBER_4E EQU 6
CYDEV_CHIP_MEMBER_4F EQU 27
CYDEV_CHIP_MEMBER_4G EQU 4
CYDEV_CHIP_MEMBER_4H EQU 24
CYDEV_CHIP_MEMBER_4I EQU 32
CYDEV_CHIP_MEMBER_4J EQU 21
CYDEV_CHIP_MEMBER_4K EQU 22
CYDEV_CHIP_MEMBER_4L EQU 31
CYDEV_CHIP_MEMBER_4M EQU 29
CYDEV_CHIP_MEMBER_4N EQU 11
CYDEV_CHIP_MEMBER_4O EQU 8
CYDEV_CHIP_MEMBER_4P EQU 28
CYDEV_CHIP_MEMBER_4Q EQU 17
CYDEV_CHIP_MEMBER_4R EQU 9
CYDEV_CHIP_MEMBER_4S EQU 12
CYDEV_CHIP_MEMBER_4T EQU 10
CYDEV_CHIP_MEMBER_4U EQU 5
CYDEV_CHIP_MEMBER_4V EQU 23
CYDEV_CHIP_MEMBER_4W EQU 13
CYDEV_CHIP_MEMBER_4X EQU 7
CYDEV_CHIP_MEMBER_4Y EQU 18
CYDEV_CHIP_MEMBER_4Z EQU 19
CYDEV_CHIP_MEMBER_5A EQU 3
CYDEV_CHIP_MEMBER_5B EQU 2
CYDEV_CHIP_MEMBER_6A EQU 33
CYDEV_CHIP_MEMBER_FM3 EQU 37
CYDEV_CHIP_MEMBER_FM4 EQU 38
CYDEV_CHIP_MEMBER_PDL_FM0P_TYPE1 EQU 34
CYDEV_CHIP_MEMBER_PDL_FM0P_TYPE2 EQU 35
CYDEV_CHIP_MEMBER_PDL_FM0P_TYPE3 EQU 36
CYDEV_CHIP_MEMBER_UNKNOWN EQU 0
CYDEV_CHIP_MEMBER_USED EQU CYDEV_CHIP_MEMBER_5B
CYDEV_CHIP_DIE_EXPECT EQU CYDEV_CHIP_MEMBER_USED
CYDEV_CHIP_DIE_ACTUAL EQU CYDEV_CHIP_DIE_EXPECT
CYDEV_CHIP_REV_LEOPARD_ES1 EQU 0
CYDEV_CHIP_REV_LEOPARD_ES2 EQU 1
CYDEV_CHIP_REV_LEOPARD_ES3 EQU 3
CYDEV_CHIP_REV_LEOPARD_PRODUCTION EQU 3
CYDEV_CHIP_REV_PSOC4A_ES0 EQU 17
CYDEV_CHIP_REV_PSOC4A_PRODUCTION EQU 17
CYDEV_CHIP_REV_PSOC5LP_ES0 EQU 0
CYDEV_CHIP_REV_PSOC5LP_PRODUCTION EQU 0
CYDEV_CHIP_REV_PSOC5TM_ES0 EQU 0
CYDEV_CHIP_REV_PSOC5TM_ES1 EQU 1
CYDEV_CHIP_REV_PSOC5TM_PRODUCTION EQU 1
CYDEV_CHIP_REV_TMA4_ES EQU 17
CYDEV_CHIP_REV_TMA4_ES2 EQU 33
CYDEV_CHIP_REV_TMA4_PRODUCTION EQU 17
CYDEV_CHIP_REVISION_3A_ES1 EQU 0
CYDEV_CHIP_REVISION_3A_ES2 EQU 1
CYDEV_CHIP_REVISION_3A_ES3 EQU 3
CYDEV_CHIP_REVISION_3A_PRODUCTION EQU 3
CYDEV_CHIP_REVISION_4A_ES0 EQU 17
CYDEV_CHIP_REVISION_4A_PRODUCTION EQU 17
CYDEV_CHIP_REVISION_4AA_PRODUCTION EQU 0
CYDEV_CHIP_REVISION_4AB_PRODUCTION EQU 0
CYDEV_CHIP_REVISION_4AC_PRODUCTION EQU 0
CYDEV_CHIP_REVISION_4AD_PRODUCTION EQU 0
CYDEV_CHIP_REVISION_4AE_PRODUCTION EQU 0
CYDEV_CHIP_REVISION_4D_PRODUCTION EQU 0
CYDEV_CHIP_REVISION_4E_CCG2_NO_USBPD EQU 0
CYDEV_CHIP_REVISION_4E_PRODUCTION EQU 0
CYDEV_CHIP_REVISION_4F_PRODUCTION EQU 0
CYDEV_CHIP_REVISION_4F_PRODUCTION_256DMA EQU 0
CYDEV_CHIP_REVISION_4F_PRODUCTION_256K EQU 0
CYDEV_CHIP_REVISION_4G_ES EQU 17
CYDEV_CHIP_REVISION_4G_ES2 EQU 33
CYDEV_CHIP_REVISION_4G_PRODUCTION EQU 17
CYDEV_CHIP_REVISION_4H_PRODUCTION EQU 0
CYDEV_CHIP_REVISION_4I_PRODUCTION EQU 0
CYDEV_CHIP_REVISION_4J_PRODUCTION EQU 0
CYDEV_CHIP_REVISION_4K_PRODUCTION EQU 0
CYDEV_CHIP_REVISION_4L_PRODUCTION EQU 0
CYDEV_CHIP_REVISION_4M_PRODUCTION EQU 0
CYDEV_CHIP_REVISION_4N_PRODUCTION EQU 0
CYDEV_CHIP_REVISION_4O_PRODUCTION EQU 0
CYDEV_CHIP_REVISION_4P_PRODUCTION EQU 0
CYDEV_CHIP_REVISION_4Q_PRODUCTION EQU 0
CYDEV_CHIP_REVISION_4R_PRODUCTION EQU 0
CYDEV_CHIP_REVISION_4S_PRODUCTION EQU 0
CYDEV_CHIP_REVISION_4T_PRODUCTION EQU 0
CYDEV_CHIP_REVISION_4U_PRODUCTION EQU 0
CYDEV_CHIP_REVISION_4V_PRODUCTION EQU 0
CYDEV_CHIP_REVISION_4W_PRODUCTION EQU 0
CYDEV_CHIP_REVISION_4X_PRODUCTION EQU 0
CYDEV_CHIP_REVISION_4Y_PRODUCTION EQU 0
CYDEV_CHIP_REVISION_4Z_PRODUCTION EQU 0
CYDEV_CHIP_REVISION_5A_ES0 EQU 0
CYDEV_CHIP_REVISION_5A_ES1 EQU 1
CYDEV_CHIP_REVISION_5A_PRODUCTION EQU 1
CYDEV_CHIP_REVISION_5B_ES0 EQU 0
CYDEV_CHIP_REVISION_5B_PRODUCTION EQU 0
CYDEV_CHIP_REVISION_6A_ES EQU 17
CYDEV_CHIP_REVISION_6A_NO_UDB EQU 33
CYDEV_CHIP_REVISION_6A_PRODUCTION EQU 33
CYDEV_CHIP_REVISION_FM3_PRODUCTION EQU 0
CYDEV_CHIP_REVISION_FM4_PRODUCTION EQU 0
CYDEV_CHIP_REVISION_PDL_FM0P_TYPE1_PRODUCTION EQU 0
CYDEV_CHIP_REVISION_PDL_FM0P_TYPE2_PRODUCTION EQU 0
CYDEV_CHIP_REVISION_PDL_FM0P_TYPE3_PRODUCTION EQU 0
CYDEV_CHIP_REVISION_USED EQU CYDEV_CHIP_REVISION_5B_PRODUCTION
CYDEV_CHIP_REV_EXPECT EQU CYDEV_CHIP_REVISION_USED
CYDEV_CONFIG_FASTBOOT_ENABLED EQU 1
CYDEV_CONFIG_UNUSED_IO_AllowButWarn EQU 0
CYDEV_CONFIG_UNUSED_IO EQU CYDEV_CONFIG_UNUSED_IO_AllowButWarn
CYDEV_CONFIG_UNUSED_IO_AllowWithInfo EQU 1
CYDEV_CONFIG_UNUSED_IO_Disallowed EQU 2
CYDEV_CONFIGURATION_COMPRESSED EQU 1
CYDEV_CONFIGURATION_DMA EQU 0
CYDEV_CONFIGURATION_ECC EQU 1
CYDEV_CONFIGURATION_IMOENABLED EQU CYDEV_CONFIG_FASTBOOT_ENABLED
CYDEV_CONFIGURATION_MODE_COMPRESSED EQU 0
CYDEV_CONFIGURATION_MODE EQU CYDEV_CONFIGURATION_MODE_COMPRESSED
CYDEV_CONFIGURATION_MODE_DMA EQU 2
CYDEV_CONFIGURATION_MODE_UNCOMPRESSED EQU 1
CYDEV_DEBUG_ENABLE_MASK EQU 0x20
CYDEV_DEBUG_ENABLE_REGISTER EQU CYREG_MLOGIC_DEBUG
CYDEV_DEBUGGING_DPS_Disable EQU 3
CYDEV_DEBUGGING_DPS_JTAG_4 EQU 1
CYDEV_DEBUGGING_DPS_JTAG_5 EQU 0
CYDEV_DEBUGGING_DPS_SWD EQU 2
CYDEV_DEBUGGING_DPS_SWD_SWV EQU 6
CYDEV_DEBUGGING_DPS EQU CYDEV_DEBUGGING_DPS_SWD_SWV
CYDEV_DEBUGGING_ENABLE EQU 1
CYDEV_DEBUGGING_XRES EQU 0
CYDEV_DMA_CHANNELS_AVAILABLE EQU 24
CYDEV_ECC_ENABLE EQU 0
CYDEV_HEAP_SIZE EQU 0x80
CYDEV_INSTRUCT_CACHE_ENABLED EQU 1
CYDEV_INTR_RISING EQU 0x00008000
CYDEV_IS_EXPORTING_CODE EQU 0
CYDEV_IS_IMPORTING_CODE EQU 0
CYDEV_PROJ_TYPE EQU 0
CYDEV_PROJ_TYPE_BOOTLOADER EQU 1
CYDEV_PROJ_TYPE_LAUNCHER EQU 5
CYDEV_PROJ_TYPE_LOADABLE EQU 2
CYDEV_PROJ_TYPE_LOADABLEANDBOOTLOADER EQU 4
CYDEV_PROJ_TYPE_MULTIAPPBOOTLOADER EQU 3
CYDEV_PROJ_TYPE_STANDARD EQU 0
CYDEV_PROTECTION_ENABLE EQU 0
CYDEV_STACK_SIZE EQU 0x0800
CYDEV_USE_BUNDLED_CMSIS EQU 1
CYDEV_VARIABLE_VDDA EQU 0
CYDEV_VDDA_MV EQU 5000
CYDEV_VDDD_MV EQU 5000
CYDEV_VDDIO0_MV EQU 5000
CYDEV_VDDIO1_MV EQU 5000
CYDEV_VDDIO2_MV EQU 5000
CYDEV_VDDIO3_MV EQU 5000
CYDEV_VIO0_MV EQU 5000
CYDEV_VIO1_MV EQU 5000
CYDEV_VIO2_MV EQU 5000
CYDEV_VIO3_MV EQU 5000
CYIPBLOCK_ARM_CM3_VERSION EQU 0
CYIPBLOCK_P3_ANAIF_VERSION EQU 0
CYIPBLOCK_P3_CAN_VERSION EQU 0
CYIPBLOCK_P3_CAPSENSE_VERSION EQU 0
CYIPBLOCK_P3_COMP_VERSION EQU 0
CYIPBLOCK_P3_DECIMATOR_VERSION EQU 0
CYIPBLOCK_P3_DFB_VERSION EQU 0
CYIPBLOCK_P3_DMA_VERSION EQU 0
CYIPBLOCK_P3_DRQ_VERSION EQU 0
CYIPBLOCK_P3_DSM_VERSION EQU 0
CYIPBLOCK_P3_EMIF_VERSION EQU 0
CYIPBLOCK_P3_I2C_VERSION EQU 0
CYIPBLOCK_P3_LCD_VERSION EQU 0
CYIPBLOCK_P3_LPF_VERSION EQU 0
CYIPBLOCK_P3_OPAMP_VERSION EQU 0
CYIPBLOCK_P3_PM_VERSION EQU 0
CYIPBLOCK_P3_SCCT_VERSION EQU 0
CYIPBLOCK_P3_TIMER_VERSION EQU 0
CYIPBLOCK_P3_USB_VERSION EQU 0
CYIPBLOCK_P3_VIDAC_VERSION EQU 0
CYIPBLOCK_P3_VREF_VERSION EQU 0
CYIPBLOCK_S8_GPIO_VERSION EQU 0
CYIPBLOCK_S8_IRQ_VERSION EQU 0
CYIPBLOCK_S8_SAR_VERSION EQU 0
CYIPBLOCK_S8_SIO_VERSION EQU 0
CYIPBLOCK_S8_UDB_VERSION EQU 0
DMA_CHANNELS_USED__MASK0 EQU 0x00000000
CYDEV_BOOTLOADER_ENABLE EQU 0
    ENDIF
    END
