/*******************************************************************************
* File Name: cyfittergnu.inc
* 
* PSoC Creator  4.4
*
* Description:
* 
* This file is automatically generated by PSoC Creator.
*
********************************************************************************
* Copyright (c) 2007-2020 Cypress Semiconductor.  All rights reserved.
* You may use this file only in accordance with the license, terms, conditions, 
* disclaimers, and limitations in the end user license agreement accompanying 
* the software package with which this file was provided.
********************************************************************************/

.ifndef INCLUDED_CYFITTERGNU_INC
.set INCLUDED_CYFITTERGNU_INC, 1
.include "cydevicegnu.inc"
.include "cydevicegnu_trm.inc"

/* I2CS */
.set I2CS_I2C_FF__ADR, CYREG_I2C_ADR
.set I2CS_I2C_FF__CFG, CYREG_I2C_CFG
.set I2CS_I2C_FF__CLK_DIV1, CYREG_I2C_CLK_DIV1
.set I2CS_I2C_FF__CLK_DIV2, CYREG_I2C_CLK_DIV2
.set I2CS_I2C_FF__CSR, CYREG_I2C_CSR
.set I2CS_I2C_FF__D, CYREG_I2C_D
.set I2CS_I2C_FF__MCSR, CYREG_I2C_MCSR
.set I2CS_I2C_FF__PM_ACT_CFG, CYREG_PM_ACT_CFG5
.set I2CS_I2C_FF__PM_ACT_MSK, 0x04
.set I2CS_I2C_FF__PM_STBY_CFG, CYREG_PM_STBY_CFG5
.set I2CS_I2C_FF__PM_STBY_MSK, 0x04
.set I2CS_I2C_FF__TMOUT_CFG0, CYREG_I2C_TMOUT_CFG0
.set I2CS_I2C_FF__TMOUT_CFG1, CYREG_I2C_TMOUT_CFG1
.set I2CS_I2C_FF__TMOUT_CSR, CYREG_I2C_TMOUT_CSR
.set I2CS_I2C_FF__TMOUT_SR, CYREG_I2C_TMOUT_SR
.set I2CS_I2C_FF__XCFG, CYREG_I2C_XCFG
.set I2CS_I2C_IRQ__INTC_CLR_EN_REG, CYREG_NVIC_CLRENA0
.set I2CS_I2C_IRQ__INTC_CLR_PD_REG, CYREG_NVIC_CLRPEND0
.set I2CS_I2C_IRQ__INTC_MASK, 0x8000
.set I2CS_I2C_IRQ__INTC_NUMBER, 15
.set I2CS_I2C_IRQ__INTC_PRIOR_NUM, 7
.set I2CS_I2C_IRQ__INTC_PRIOR_REG, CYREG_NVIC_PRI_15
.set I2CS_I2C_IRQ__INTC_SET_EN_REG, CYREG_NVIC_SETENA0
.set I2CS_I2C_IRQ__INTC_SET_PD_REG, CYREG_NVIC_SETPEND0

/* ADC_1 */
.set ADC_1_Bypass_P03__0__INTTYPE, CYREG_PICU0_INTTYPE3
.set ADC_1_Bypass_P03__0__MASK, 0x08
.set ADC_1_Bypass_P03__0__PC, CYREG_PRT0_PC3
.set ADC_1_Bypass_P03__0__PORT, 0
.set ADC_1_Bypass_P03__0__SHIFT, 3
.set ADC_1_Bypass_P03__AG, CYREG_PRT0_AG
.set ADC_1_Bypass_P03__AMUX, CYREG_PRT0_AMUX
.set ADC_1_Bypass_P03__BIE, CYREG_PRT0_BIE
.set ADC_1_Bypass_P03__BIT_MASK, CYREG_PRT0_BIT_MASK
.set ADC_1_Bypass_P03__BYP, CYREG_PRT0_BYP
.set ADC_1_Bypass_P03__CTL, CYREG_PRT0_CTL
.set ADC_1_Bypass_P03__DM0, CYREG_PRT0_DM0
.set ADC_1_Bypass_P03__DM1, CYREG_PRT0_DM1
.set ADC_1_Bypass_P03__DM2, CYREG_PRT0_DM2
.set ADC_1_Bypass_P03__DR, CYREG_PRT0_DR
.set ADC_1_Bypass_P03__INP_DIS, CYREG_PRT0_INP_DIS
.set ADC_1_Bypass_P03__INTTYPE_BASE, CYDEV_PICU_INTTYPE_PICU0_BASE
.set ADC_1_Bypass_P03__LCD_COM_SEG, CYREG_PRT0_LCD_COM_SEG
.set ADC_1_Bypass_P03__LCD_EN, CYREG_PRT0_LCD_EN
.set ADC_1_Bypass_P03__MASK, 0x08
.set ADC_1_Bypass_P03__PORT, 0
.set ADC_1_Bypass_P03__PRT, CYREG_PRT0_PRT
.set ADC_1_Bypass_P03__PRTDSI__CAPS_SEL, CYREG_PRT0_CAPS_SEL
.set ADC_1_Bypass_P03__PRTDSI__DBL_SYNC_IN, CYREG_PRT0_DBL_SYNC_IN
.set ADC_1_Bypass_P03__PRTDSI__OE_SEL0, CYREG_PRT0_OE_SEL0
.set ADC_1_Bypass_P03__PRTDSI__OE_SEL1, CYREG_PRT0_OE_SEL1
.set ADC_1_Bypass_P03__PRTDSI__OUT_SEL0, CYREG_PRT0_OUT_SEL0
.set ADC_1_Bypass_P03__PRTDSI__OUT_SEL1, CYREG_PRT0_OUT_SEL1
.set ADC_1_Bypass_P03__PRTDSI__SYNC_OUT, CYREG_PRT0_SYNC_OUT
.set ADC_1_Bypass_P03__PS, CYREG_PRT0_PS
.set ADC_1_Bypass_P03__SHIFT, 3
.set ADC_1_Bypass_P03__SLW, CYREG_PRT0_SLW
.set ADC_1_DEC__COHER, CYREG_DEC_COHER
.set ADC_1_DEC__CR, CYREG_DEC_CR
.set ADC_1_DEC__DR1, CYREG_DEC_DR1
.set ADC_1_DEC__DR2, CYREG_DEC_DR2
.set ADC_1_DEC__DR2H, CYREG_DEC_DR2H
.set ADC_1_DEC__GCOR, CYREG_DEC_GCOR
.set ADC_1_DEC__GCORH, CYREG_DEC_GCORH
.set ADC_1_DEC__GVAL, CYREG_DEC_GVAL
.set ADC_1_DEC__OCOR, CYREG_DEC_OCOR
.set ADC_1_DEC__OCORH, CYREG_DEC_OCORH
.set ADC_1_DEC__OCORM, CYREG_DEC_OCORM
.set ADC_1_DEC__OUTSAMP, CYREG_DEC_OUTSAMP
.set ADC_1_DEC__OUTSAMPH, CYREG_DEC_OUTSAMPH
.set ADC_1_DEC__OUTSAMPM, CYREG_DEC_OUTSAMPM
.set ADC_1_DEC__OUTSAMPS, CYREG_DEC_OUTSAMPS
.set ADC_1_DEC__PM_ACT_CFG, CYREG_PM_ACT_CFG10
.set ADC_1_DEC__PM_ACT_MSK, 0x01
.set ADC_1_DEC__PM_STBY_CFG, CYREG_PM_STBY_CFG10
.set ADC_1_DEC__PM_STBY_MSK, 0x01
.set ADC_1_DEC__SHIFT1, CYREG_DEC_SHIFT1
.set ADC_1_DEC__SHIFT2, CYREG_DEC_SHIFT2
.set ADC_1_DEC__SR, CYREG_DEC_SR
.set ADC_1_DEC__TRIM__M1, CYREG_FLSHID_CUST_TABLES_DEC_M1
.set ADC_1_DEC__TRIM__M2, CYREG_FLSHID_CUST_TABLES_DEC_M2
.set ADC_1_DEC__TRIM__M3, CYREG_FLSHID_CUST_TABLES_DEC_M3
.set ADC_1_DEC__TRIM__M4, CYREG_FLSHID_CUST_TABLES_DEC_M4
.set ADC_1_DEC__TRIM__M5, CYREG_FLSHID_CUST_TABLES_DEC_M5
.set ADC_1_DEC__TRIM__M6, CYREG_FLSHID_CUST_TABLES_DEC_M6
.set ADC_1_DEC__TRIM__M7, CYREG_FLSHID_CUST_TABLES_DEC_M7
.set ADC_1_DEC__TRIM__M8, CYREG_FLSHID_CUST_TABLES_DEC_M8
.set ADC_1_DSM__BUF0, CYREG_DSM0_BUF0
.set ADC_1_DSM__BUF1, CYREG_DSM0_BUF1
.set ADC_1_DSM__BUF2, CYREG_DSM0_BUF2
.set ADC_1_DSM__BUF3, CYREG_DSM0_BUF3
.set ADC_1_DSM__CLK, CYREG_DSM0_CLK
.set ADC_1_DSM__CR0, CYREG_DSM0_CR0
.set ADC_1_DSM__CR1, CYREG_DSM0_CR1
.set ADC_1_DSM__CR10, CYREG_DSM0_CR10
.set ADC_1_DSM__CR11, CYREG_DSM0_CR11
.set ADC_1_DSM__CR12, CYREG_DSM0_CR12
.set ADC_1_DSM__CR13, CYREG_DSM0_CR13
.set ADC_1_DSM__CR14, CYREG_DSM0_CR14
.set ADC_1_DSM__CR15, CYREG_DSM0_CR15
.set ADC_1_DSM__CR16, CYREG_DSM0_CR16
.set ADC_1_DSM__CR17, CYREG_DSM0_CR17
.set ADC_1_DSM__CR2, CYREG_DSM0_CR2
.set ADC_1_DSM__CR3, CYREG_DSM0_CR3
.set ADC_1_DSM__CR4, CYREG_DSM0_CR4
.set ADC_1_DSM__CR5, CYREG_DSM0_CR5
.set ADC_1_DSM__CR6, CYREG_DSM0_CR6
.set ADC_1_DSM__CR7, CYREG_DSM0_CR7
.set ADC_1_DSM__CR8, CYREG_DSM0_CR8
.set ADC_1_DSM__CR9, CYREG_DSM0_CR9
.set ADC_1_DSM__DEM0, CYREG_DSM0_DEM0
.set ADC_1_DSM__DEM1, CYREG_DSM0_DEM1
.set ADC_1_DSM__MISC, CYREG_DSM0_MISC
.set ADC_1_DSM__OUT0, CYREG_DSM0_OUT0
.set ADC_1_DSM__OUT1, CYREG_DSM0_OUT1
.set ADC_1_DSM__REF0, CYREG_DSM0_REF0
.set ADC_1_DSM__REF1, CYREG_DSM0_REF1
.set ADC_1_DSM__REF2, CYREG_DSM0_REF2
.set ADC_1_DSM__REF3, CYREG_DSM0_REF3
.set ADC_1_DSM__RSVD1, CYREG_DSM0_RSVD1
.set ADC_1_DSM__SW0, CYREG_DSM0_SW0
.set ADC_1_DSM__SW2, CYREG_DSM0_SW2
.set ADC_1_DSM__SW3, CYREG_DSM0_SW3
.set ADC_1_DSM__SW4, CYREG_DSM0_SW4
.set ADC_1_DSM__SW6, CYREG_DSM0_SW6
.set ADC_1_DSM__TR0, CYREG_NPUMP_DSM_TR0
.set ADC_1_DSM__TST0, CYREG_DSM0_TST0
.set ADC_1_DSM__TST1, CYREG_DSM0_TST1
.set ADC_1_Ext_CP_Clk__CFG0, CYREG_CLKDIST_DCFG0_CFG0
.set ADC_1_Ext_CP_Clk__CFG1, CYREG_CLKDIST_DCFG0_CFG1
.set ADC_1_Ext_CP_Clk__CFG2, CYREG_CLKDIST_DCFG0_CFG2
.set ADC_1_Ext_CP_Clk__CFG2_SRC_SEL_MASK, 0x07
.set ADC_1_Ext_CP_Clk__INDEX, 0x00
.set ADC_1_Ext_CP_Clk__PM_ACT_CFG, CYREG_PM_ACT_CFG2
.set ADC_1_Ext_CP_Clk__PM_ACT_MSK, 0x01
.set ADC_1_Ext_CP_Clk__PM_STBY_CFG, CYREG_PM_STBY_CFG2
.set ADC_1_Ext_CP_Clk__PM_STBY_MSK, 0x01
.set ADC_1_IRQ__INTC_CLR_EN_REG, CYREG_NVIC_CLRENA0
.set ADC_1_IRQ__INTC_CLR_PD_REG, CYREG_NVIC_CLRPEND0
.set ADC_1_IRQ__INTC_MASK, 0x20000000
.set ADC_1_IRQ__INTC_NUMBER, 29
.set ADC_1_IRQ__INTC_PRIOR_NUM, 7
.set ADC_1_IRQ__INTC_PRIOR_REG, CYREG_NVIC_PRI_29
.set ADC_1_IRQ__INTC_SET_EN_REG, CYREG_NVIC_SETENA0
.set ADC_1_IRQ__INTC_SET_PD_REG, CYREG_NVIC_SETPEND0
.set ADC_1_theACLK__CFG0, CYREG_CLKDIST_ACFG0_CFG0
.set ADC_1_theACLK__CFG1, CYREG_CLKDIST_ACFG0_CFG1
.set ADC_1_theACLK__CFG2, CYREG_CLKDIST_ACFG0_CFG2
.set ADC_1_theACLK__CFG2_SRC_SEL_MASK, 0x07
.set ADC_1_theACLK__CFG3, CYREG_CLKDIST_ACFG0_CFG3
.set ADC_1_theACLK__CFG3_PHASE_DLY_MASK, 0x0F
.set ADC_1_theACLK__INDEX, 0x00
.set ADC_1_theACLK__PM_ACT_CFG, CYREG_PM_ACT_CFG1
.set ADC_1_theACLK__PM_ACT_MSK, 0x01
.set ADC_1_theACLK__PM_STBY_CFG, CYREG_PM_STBY_CFG1
.set ADC_1_theACLK__PM_STBY_MSK, 0x01

/* MUX_0 */
.set MUX_0__0__INTTYPE, CYREG_PICU15_INTTYPE0
.set MUX_0__0__MASK, 0x01
.set MUX_0__0__PC, CYREG_IO_PC_PRT15_PC0
.set MUX_0__0__PORT, 15
.set MUX_0__0__SHIFT, 0
.set MUX_0__AG, CYREG_PRT15_AG
.set MUX_0__AMUX, CYREG_PRT15_AMUX
.set MUX_0__BIE, CYREG_PRT15_BIE
.set MUX_0__BIT_MASK, CYREG_PRT15_BIT_MASK
.set MUX_0__BYP, CYREG_PRT15_BYP
.set MUX_0__CTL, CYREG_PRT15_CTL
.set MUX_0__DM0, CYREG_PRT15_DM0
.set MUX_0__DM1, CYREG_PRT15_DM1
.set MUX_0__DM2, CYREG_PRT15_DM2
.set MUX_0__DR, CYREG_PRT15_DR
.set MUX_0__INP_DIS, CYREG_PRT15_INP_DIS
.set MUX_0__INTTYPE_BASE, CYDEV_PICU_INTTYPE_PICU15_BASE
.set MUX_0__LCD_COM_SEG, CYREG_PRT15_LCD_COM_SEG
.set MUX_0__LCD_EN, CYREG_PRT15_LCD_EN
.set MUX_0__MASK, 0x01
.set MUX_0__PORT, 15
.set MUX_0__PRT, CYREG_PRT15_PRT
.set MUX_0__PRTDSI__CAPS_SEL, CYREG_PRT15_CAPS_SEL
.set MUX_0__PRTDSI__DBL_SYNC_IN, CYREG_PRT15_DBL_SYNC_IN
.set MUX_0__PRTDSI__OE_SEL0, CYREG_PRT15_OE_SEL0
.set MUX_0__PRTDSI__OE_SEL1, CYREG_PRT15_OE_SEL1
.set MUX_0__PRTDSI__OUT_SEL0, CYREG_PRT15_OUT_SEL0
.set MUX_0__PRTDSI__OUT_SEL1, CYREG_PRT15_OUT_SEL1
.set MUX_0__PRTDSI__SYNC_OUT, CYREG_PRT15_SYNC_OUT
.set MUX_0__PS, CYREG_PRT15_PS
.set MUX_0__SHIFT, 0
.set MUX_0__SLW, CYREG_PRT15_SLW

/* MUX_1 */
.set MUX_1__0__INTTYPE, CYREG_PICU15_INTTYPE1
.set MUX_1__0__MASK, 0x02
.set MUX_1__0__PC, CYREG_IO_PC_PRT15_PC1
.set MUX_1__0__PORT, 15
.set MUX_1__0__SHIFT, 1
.set MUX_1__AG, CYREG_PRT15_AG
.set MUX_1__AMUX, CYREG_PRT15_AMUX
.set MUX_1__BIE, CYREG_PRT15_BIE
.set MUX_1__BIT_MASK, CYREG_PRT15_BIT_MASK
.set MUX_1__BYP, CYREG_PRT15_BYP
.set MUX_1__CTL, CYREG_PRT15_CTL
.set MUX_1__DM0, CYREG_PRT15_DM0
.set MUX_1__DM1, CYREG_PRT15_DM1
.set MUX_1__DM2, CYREG_PRT15_DM2
.set MUX_1__DR, CYREG_PRT15_DR
.set MUX_1__INP_DIS, CYREG_PRT15_INP_DIS
.set MUX_1__INTTYPE_BASE, CYDEV_PICU_INTTYPE_PICU15_BASE
.set MUX_1__LCD_COM_SEG, CYREG_PRT15_LCD_COM_SEG
.set MUX_1__LCD_EN, CYREG_PRT15_LCD_EN
.set MUX_1__MASK, 0x02
.set MUX_1__PORT, 15
.set MUX_1__PRT, CYREG_PRT15_PRT
.set MUX_1__PRTDSI__CAPS_SEL, CYREG_PRT15_CAPS_SEL
.set MUX_1__PRTDSI__DBL_SYNC_IN, CYREG_PRT15_DBL_SYNC_IN
.set MUX_1__PRTDSI__OE_SEL0, CYREG_PRT15_OE_SEL0
.set MUX_1__PRTDSI__OE_SEL1, CYREG_PRT15_OE_SEL1
.set MUX_1__PRTDSI__OUT_SEL0, CYREG_PRT15_OUT_SEL0
.set MUX_1__PRTDSI__OUT_SEL1, CYREG_PRT15_OUT_SEL1
.set MUX_1__PRTDSI__SYNC_OUT, CYREG_PRT15_SYNC_OUT
.set MUX_1__PS, CYREG_PRT15_PS
.set MUX_1__SHIFT, 1
.set MUX_1__SLW, CYREG_PRT15_SLW

/* Pin_1 */
.set Pin_1__0__INTTYPE, CYREG_PICU2_INTTYPE7
.set Pin_1__0__MASK, 0x80
.set Pin_1__0__PC, CYREG_PRT2_PC7
.set Pin_1__0__PORT, 2
.set Pin_1__0__SHIFT, 7
.set Pin_1__AG, CYREG_PRT2_AG
.set Pin_1__AMUX, CYREG_PRT2_AMUX
.set Pin_1__BIE, CYREG_PRT2_BIE
.set Pin_1__BIT_MASK, CYREG_PRT2_BIT_MASK
.set Pin_1__BYP, CYREG_PRT2_BYP
.set Pin_1__CTL, CYREG_PRT2_CTL
.set Pin_1__DM0, CYREG_PRT2_DM0
.set Pin_1__DM1, CYREG_PRT2_DM1
.set Pin_1__DM2, CYREG_PRT2_DM2
.set Pin_1__DR, CYREG_PRT2_DR
.set Pin_1__INP_DIS, CYREG_PRT2_INP_DIS
.set Pin_1__INTTYPE_BASE, CYDEV_PICU_INTTYPE_PICU2_BASE
.set Pin_1__LCD_COM_SEG, CYREG_PRT2_LCD_COM_SEG
.set Pin_1__LCD_EN, CYREG_PRT2_LCD_EN
.set Pin_1__MASK, 0x80
.set Pin_1__PORT, 2
.set Pin_1__PRT, CYREG_PRT2_PRT
.set Pin_1__PRTDSI__CAPS_SEL, CYREG_PRT2_CAPS_SEL
.set Pin_1__PRTDSI__DBL_SYNC_IN, CYREG_PRT2_DBL_SYNC_IN
.set Pin_1__PRTDSI__OE_SEL0, CYREG_PRT2_OE_SEL0
.set Pin_1__PRTDSI__OE_SEL1, CYREG_PRT2_OE_SEL1
.set Pin_1__PRTDSI__OUT_SEL0, CYREG_PRT2_OUT_SEL0
.set Pin_1__PRTDSI__OUT_SEL1, CYREG_PRT2_OUT_SEL1
.set Pin_1__PRTDSI__SYNC_OUT, CYREG_PRT2_SYNC_OUT
.set Pin_1__PS, CYREG_PRT2_PS
.set Pin_1__SHIFT, 7
.set Pin_1__SLW, CYREG_PRT2_SLW

/* Pin_2 */
.set Pin_2__0__INTTYPE, CYREG_PICU2_INTTYPE6
.set Pin_2__0__MASK, 0x40
.set Pin_2__0__PC, CYREG_PRT2_PC6
.set Pin_2__0__PORT, 2
.set Pin_2__0__SHIFT, 6
.set Pin_2__AG, CYREG_PRT2_AG
.set Pin_2__AMUX, CYREG_PRT2_AMUX
.set Pin_2__BIE, CYREG_PRT2_BIE
.set Pin_2__BIT_MASK, CYREG_PRT2_BIT_MASK
.set Pin_2__BYP, CYREG_PRT2_BYP
.set Pin_2__CTL, CYREG_PRT2_CTL
.set Pin_2__DM0, CYREG_PRT2_DM0
.set Pin_2__DM1, CYREG_PRT2_DM1
.set Pin_2__DM2, CYREG_PRT2_DM2
.set Pin_2__DR, CYREG_PRT2_DR
.set Pin_2__INP_DIS, CYREG_PRT2_INP_DIS
.set Pin_2__INTTYPE_BASE, CYDEV_PICU_INTTYPE_PICU2_BASE
.set Pin_2__LCD_COM_SEG, CYREG_PRT2_LCD_COM_SEG
.set Pin_2__LCD_EN, CYREG_PRT2_LCD_EN
.set Pin_2__MASK, 0x40
.set Pin_2__PORT, 2
.set Pin_2__PRT, CYREG_PRT2_PRT
.set Pin_2__PRTDSI__CAPS_SEL, CYREG_PRT2_CAPS_SEL
.set Pin_2__PRTDSI__DBL_SYNC_IN, CYREG_PRT2_DBL_SYNC_IN
.set Pin_2__PRTDSI__OE_SEL0, CYREG_PRT2_OE_SEL0
.set Pin_2__PRTDSI__OE_SEL1, CYREG_PRT2_OE_SEL1
.set Pin_2__PRTDSI__OUT_SEL0, CYREG_PRT2_OUT_SEL0
.set Pin_2__PRTDSI__OUT_SEL1, CYREG_PRT2_OUT_SEL1
.set Pin_2__PRTDSI__SYNC_OUT, CYREG_PRT2_SYNC_OUT
.set Pin_2__PS, CYREG_PRT2_PS
.set Pin_2__SHIFT, 6
.set Pin_2__SLW, CYREG_PRT2_SLW

/* SCL_1 */
.set SCL_1__0__INTTYPE, CYREG_PICU12_INTTYPE0
.set SCL_1__0__MASK, 0x01
.set SCL_1__0__PC, CYREG_PRT12_PC0
.set SCL_1__0__PORT, 12
.set SCL_1__0__SHIFT, 0
.set SCL_1__AG, CYREG_PRT12_AG
.set SCL_1__BIE, CYREG_PRT12_BIE
.set SCL_1__BIT_MASK, CYREG_PRT12_BIT_MASK
.set SCL_1__BYP, CYREG_PRT12_BYP
.set SCL_1__DM0, CYREG_PRT12_DM0
.set SCL_1__DM1, CYREG_PRT12_DM1
.set SCL_1__DM2, CYREG_PRT12_DM2
.set SCL_1__DR, CYREG_PRT12_DR
.set SCL_1__INP_DIS, CYREG_PRT12_INP_DIS
.set SCL_1__INTTYPE_BASE, CYDEV_PICU_INTTYPE_PICU12_BASE
.set SCL_1__MASK, 0x01
.set SCL_1__PORT, 12
.set SCL_1__PRT, CYREG_PRT12_PRT
.set SCL_1__PRTDSI__DBL_SYNC_IN, CYREG_PRT12_DBL_SYNC_IN
.set SCL_1__PRTDSI__OE_SEL0, CYREG_PRT12_OE_SEL0
.set SCL_1__PRTDSI__OE_SEL1, CYREG_PRT12_OE_SEL1
.set SCL_1__PRTDSI__OUT_SEL0, CYREG_PRT12_OUT_SEL0
.set SCL_1__PRTDSI__OUT_SEL1, CYREG_PRT12_OUT_SEL1
.set SCL_1__PRTDSI__SYNC_OUT, CYREG_PRT12_SYNC_OUT
.set SCL_1__PS, CYREG_PRT12_PS
.set SCL_1__SHIFT, 0
.set SCL_1__SIO_CFG, CYREG_PRT12_SIO_CFG
.set SCL_1__SIO_DIFF, CYREG_PRT12_SIO_DIFF
.set SCL_1__SIO_HYST_EN, CYREG_PRT12_SIO_HYST_EN
.set SCL_1__SIO_REG_HIFREQ, CYREG_PRT12_SIO_REG_HIFREQ
.set SCL_1__SLW, CYREG_PRT12_SLW

/* SDA_1 */
.set SDA_1__0__INTTYPE, CYREG_PICU12_INTTYPE1
.set SDA_1__0__MASK, 0x02
.set SDA_1__0__PC, CYREG_PRT12_PC1
.set SDA_1__0__PORT, 12
.set SDA_1__0__SHIFT, 1
.set SDA_1__AG, CYREG_PRT12_AG
.set SDA_1__BIE, CYREG_PRT12_BIE
.set SDA_1__BIT_MASK, CYREG_PRT12_BIT_MASK
.set SDA_1__BYP, CYREG_PRT12_BYP
.set SDA_1__DM0, CYREG_PRT12_DM0
.set SDA_1__DM1, CYREG_PRT12_DM1
.set SDA_1__DM2, CYREG_PRT12_DM2
.set SDA_1__DR, CYREG_PRT12_DR
.set SDA_1__INP_DIS, CYREG_PRT12_INP_DIS
.set SDA_1__INTTYPE_BASE, CYDEV_PICU_INTTYPE_PICU12_BASE
.set SDA_1__MASK, 0x02
.set SDA_1__PORT, 12
.set SDA_1__PRT, CYREG_PRT12_PRT
.set SDA_1__PRTDSI__DBL_SYNC_IN, CYREG_PRT12_DBL_SYNC_IN
.set SDA_1__PRTDSI__OE_SEL0, CYREG_PRT12_OE_SEL0
.set SDA_1__PRTDSI__OE_SEL1, CYREG_PRT12_OE_SEL1
.set SDA_1__PRTDSI__OUT_SEL0, CYREG_PRT12_OUT_SEL0
.set SDA_1__PRTDSI__OUT_SEL1, CYREG_PRT12_OUT_SEL1
.set SDA_1__PRTDSI__SYNC_OUT, CYREG_PRT12_SYNC_OUT
.set SDA_1__PS, CYREG_PRT12_PS
.set SDA_1__SHIFT, 1
.set SDA_1__SIO_CFG, CYREG_PRT12_SIO_CFG
.set SDA_1__SIO_DIFF, CYREG_PRT12_SIO_DIFF
.set SDA_1__SIO_HYST_EN, CYREG_PRT12_SIO_HYST_EN
.set SDA_1__SIO_REG_HIFREQ, CYREG_PRT12_SIO_REG_HIFREQ
.set SDA_1__SLW, CYREG_PRT12_SLW

/* MUX_En */
.set MUX_En__0__INTTYPE, CYREG_PICU15_INTTYPE5
.set MUX_En__0__MASK, 0x20
.set MUX_En__0__PC, CYREG_IO_PC_PRT15_PC5
.set MUX_En__0__PORT, 15
.set MUX_En__0__SHIFT, 5
.set MUX_En__AG, CYREG_PRT15_AG
.set MUX_En__AMUX, CYREG_PRT15_AMUX
.set MUX_En__BIE, CYREG_PRT15_BIE
.set MUX_En__BIT_MASK, CYREG_PRT15_BIT_MASK
.set MUX_En__BYP, CYREG_PRT15_BYP
.set MUX_En__CTL, CYREG_PRT15_CTL
.set MUX_En__DM0, CYREG_PRT15_DM0
.set MUX_En__DM1, CYREG_PRT15_DM1
.set MUX_En__DM2, CYREG_PRT15_DM2
.set MUX_En__DR, CYREG_PRT15_DR
.set MUX_En__INP_DIS, CYREG_PRT15_INP_DIS
.set MUX_En__INTTYPE_BASE, CYDEV_PICU_INTTYPE_PICU15_BASE
.set MUX_En__LCD_COM_SEG, CYREG_PRT15_LCD_COM_SEG
.set MUX_En__LCD_EN, CYREG_PRT15_LCD_EN
.set MUX_En__MASK, 0x20
.set MUX_En__PORT, 15
.set MUX_En__PRT, CYREG_PRT15_PRT
.set MUX_En__PRTDSI__CAPS_SEL, CYREG_PRT15_CAPS_SEL
.set MUX_En__PRTDSI__DBL_SYNC_IN, CYREG_PRT15_DBL_SYNC_IN
.set MUX_En__PRTDSI__OE_SEL0, CYREG_PRT15_OE_SEL0
.set MUX_En__PRTDSI__OE_SEL1, CYREG_PRT15_OE_SEL1
.set MUX_En__PRTDSI__OUT_SEL0, CYREG_PRT15_OUT_SEL0
.set MUX_En__PRTDSI__OUT_SEL1, CYREG_PRT15_OUT_SEL1
.set MUX_En__PRTDSI__SYNC_OUT, CYREG_PRT15_SYNC_OUT
.set MUX_En__PS, CYREG_PRT15_PS
.set MUX_En__SHIFT, 5
.set MUX_En__SLW, CYREG_PRT15_SLW

/* string1 */
.set string1__0__INTTYPE, CYREG_PICU0_INTTYPE4
.set string1__0__MASK, 0x10
.set string1__0__PC, CYREG_PRT0_PC4
.set string1__0__PORT, 0
.set string1__0__SHIFT, 4
.set string1__AG, CYREG_PRT0_AG
.set string1__AMUX, CYREG_PRT0_AMUX
.set string1__BIE, CYREG_PRT0_BIE
.set string1__BIT_MASK, CYREG_PRT0_BIT_MASK
.set string1__BYP, CYREG_PRT0_BYP
.set string1__CTL, CYREG_PRT0_CTL
.set string1__DM0, CYREG_PRT0_DM0
.set string1__DM1, CYREG_PRT0_DM1
.set string1__DM2, CYREG_PRT0_DM2
.set string1__DR, CYREG_PRT0_DR
.set string1__INP_DIS, CYREG_PRT0_INP_DIS
.set string1__INTTYPE_BASE, CYDEV_PICU_INTTYPE_PICU0_BASE
.set string1__LCD_COM_SEG, CYREG_PRT0_LCD_COM_SEG
.set string1__LCD_EN, CYREG_PRT0_LCD_EN
.set string1__MASK, 0x10
.set string1__PORT, 0
.set string1__PRT, CYREG_PRT0_PRT
.set string1__PRTDSI__CAPS_SEL, CYREG_PRT0_CAPS_SEL
.set string1__PRTDSI__DBL_SYNC_IN, CYREG_PRT0_DBL_SYNC_IN
.set string1__PRTDSI__OE_SEL0, CYREG_PRT0_OE_SEL0
.set string1__PRTDSI__OE_SEL1, CYREG_PRT0_OE_SEL1
.set string1__PRTDSI__OUT_SEL0, CYREG_PRT0_OUT_SEL0
.set string1__PRTDSI__OUT_SEL1, CYREG_PRT0_OUT_SEL1
.set string1__PRTDSI__SYNC_OUT, CYREG_PRT0_SYNC_OUT
.set string1__PS, CYREG_PRT0_PS
.set string1__SHIFT, 4
.set string1__SLW, CYREG_PRT0_SLW

/* string2 */
.set string2__0__INTTYPE, CYREG_PICU0_INTTYPE5
.set string2__0__MASK, 0x20
.set string2__0__PC, CYREG_PRT0_PC5
.set string2__0__PORT, 0
.set string2__0__SHIFT, 5
.set string2__AG, CYREG_PRT0_AG
.set string2__AMUX, CYREG_PRT0_AMUX
.set string2__BIE, CYREG_PRT0_BIE
.set string2__BIT_MASK, CYREG_PRT0_BIT_MASK
.set string2__BYP, CYREG_PRT0_BYP
.set string2__CTL, CYREG_PRT0_CTL
.set string2__DM0, CYREG_PRT0_DM0
.set string2__DM1, CYREG_PRT0_DM1
.set string2__DM2, CYREG_PRT0_DM2
.set string2__DR, CYREG_PRT0_DR
.set string2__INP_DIS, CYREG_PRT0_INP_DIS
.set string2__INTTYPE_BASE, CYDEV_PICU_INTTYPE_PICU0_BASE
.set string2__LCD_COM_SEG, CYREG_PRT0_LCD_COM_SEG
.set string2__LCD_EN, CYREG_PRT0_LCD_EN
.set string2__MASK, 0x20
.set string2__PORT, 0
.set string2__PRT, CYREG_PRT0_PRT
.set string2__PRTDSI__CAPS_SEL, CYREG_PRT0_CAPS_SEL
.set string2__PRTDSI__DBL_SYNC_IN, CYREG_PRT0_DBL_SYNC_IN
.set string2__PRTDSI__OE_SEL0, CYREG_PRT0_OE_SEL0
.set string2__PRTDSI__OE_SEL1, CYREG_PRT0_OE_SEL1
.set string2__PRTDSI__OUT_SEL0, CYREG_PRT0_OUT_SEL0
.set string2__PRTDSI__OUT_SEL1, CYREG_PRT0_OUT_SEL1
.set string2__PRTDSI__SYNC_OUT, CYREG_PRT0_SYNC_OUT
.set string2__PS, CYREG_PRT0_PS
.set string2__SHIFT, 5
.set string2__SLW, CYREG_PRT0_SLW

/* string3 */
.set string3__0__INTTYPE, CYREG_PICU0_INTTYPE6
.set string3__0__MASK, 0x40
.set string3__0__PC, CYREG_PRT0_PC6
.set string3__0__PORT, 0
.set string3__0__SHIFT, 6
.set string3__AG, CYREG_PRT0_AG
.set string3__AMUX, CYREG_PRT0_AMUX
.set string3__BIE, CYREG_PRT0_BIE
.set string3__BIT_MASK, CYREG_PRT0_BIT_MASK
.set string3__BYP, CYREG_PRT0_BYP
.set string3__CTL, CYREG_PRT0_CTL
.set string3__DM0, CYREG_PRT0_DM0
.set string3__DM1, CYREG_PRT0_DM1
.set string3__DM2, CYREG_PRT0_DM2
.set string3__DR, CYREG_PRT0_DR
.set string3__INP_DIS, CYREG_PRT0_INP_DIS
.set string3__INTTYPE_BASE, CYDEV_PICU_INTTYPE_PICU0_BASE
.set string3__LCD_COM_SEG, CYREG_PRT0_LCD_COM_SEG
.set string3__LCD_EN, CYREG_PRT0_LCD_EN
.set string3__MASK, 0x40
.set string3__PORT, 0
.set string3__PRT, CYREG_PRT0_PRT
.set string3__PRTDSI__CAPS_SEL, CYREG_PRT0_CAPS_SEL
.set string3__PRTDSI__DBL_SYNC_IN, CYREG_PRT0_DBL_SYNC_IN
.set string3__PRTDSI__OE_SEL0, CYREG_PRT0_OE_SEL0
.set string3__PRTDSI__OE_SEL1, CYREG_PRT0_OE_SEL1
.set string3__PRTDSI__OUT_SEL0, CYREG_PRT0_OUT_SEL0
.set string3__PRTDSI__OUT_SEL1, CYREG_PRT0_OUT_SEL1
.set string3__PRTDSI__SYNC_OUT, CYREG_PRT0_SYNC_OUT
.set string3__PS, CYREG_PRT0_PS
.set string3__SHIFT, 6
.set string3__SLW, CYREG_PRT0_SLW

/* string4 */
.set string4__0__INTTYPE, CYREG_PICU0_INTTYPE7
.set string4__0__MASK, 0x80
.set string4__0__PC, CYREG_PRT0_PC7
.set string4__0__PORT, 0
.set string4__0__SHIFT, 7
.set string4__AG, CYREG_PRT0_AG
.set string4__AMUX, CYREG_PRT0_AMUX
.set string4__BIE, CYREG_PRT0_BIE
.set string4__BIT_MASK, CYREG_PRT0_BIT_MASK
.set string4__BYP, CYREG_PRT0_BYP
.set string4__CTL, CYREG_PRT0_CTL
.set string4__DM0, CYREG_PRT0_DM0
.set string4__DM1, CYREG_PRT0_DM1
.set string4__DM2, CYREG_PRT0_DM2
.set string4__DR, CYREG_PRT0_DR
.set string4__INP_DIS, CYREG_PRT0_INP_DIS
.set string4__INTTYPE_BASE, CYDEV_PICU_INTTYPE_PICU0_BASE
.set string4__LCD_COM_SEG, CYREG_PRT0_LCD_COM_SEG
.set string4__LCD_EN, CYREG_PRT0_LCD_EN
.set string4__MASK, 0x80
.set string4__PORT, 0
.set string4__PRT, CYREG_PRT0_PRT
.set string4__PRTDSI__CAPS_SEL, CYREG_PRT0_CAPS_SEL
.set string4__PRTDSI__DBL_SYNC_IN, CYREG_PRT0_DBL_SYNC_IN
.set string4__PRTDSI__OE_SEL0, CYREG_PRT0_OE_SEL0
.set string4__PRTDSI__OE_SEL1, CYREG_PRT0_OE_SEL1
.set string4__PRTDSI__OUT_SEL0, CYREG_PRT0_OUT_SEL0
.set string4__PRTDSI__OUT_SEL1, CYREG_PRT0_OUT_SEL1
.set string4__PRTDSI__SYNC_OUT, CYREG_PRT0_SYNC_OUT
.set string4__PS, CYREG_PRT0_PS
.set string4__SHIFT, 7
.set string4__SLW, CYREG_PRT0_SLW

/* vddaout */
.set vddaout__0__INTTYPE, CYREG_PICU0_INTTYPE2
.set vddaout__0__MASK, 0x04
.set vddaout__0__PC, CYREG_PRT0_PC2
.set vddaout__0__PORT, 0
.set vddaout__0__SHIFT, 2
.set vddaout__AG, CYREG_PRT0_AG
.set vddaout__AMUX, CYREG_PRT0_AMUX
.set vddaout__BIE, CYREG_PRT0_BIE
.set vddaout__BIT_MASK, CYREG_PRT0_BIT_MASK
.set vddaout__BYP, CYREG_PRT0_BYP
.set vddaout__CTL, CYREG_PRT0_CTL
.set vddaout__DM0, CYREG_PRT0_DM0
.set vddaout__DM1, CYREG_PRT0_DM1
.set vddaout__DM2, CYREG_PRT0_DM2
.set vddaout__DR, CYREG_PRT0_DR
.set vddaout__INP_DIS, CYREG_PRT0_INP_DIS
.set vddaout__INTTYPE_BASE, CYDEV_PICU_INTTYPE_PICU0_BASE
.set vddaout__LCD_COM_SEG, CYREG_PRT0_LCD_COM_SEG
.set vddaout__LCD_EN, CYREG_PRT0_LCD_EN
.set vddaout__MASK, 0x04
.set vddaout__PORT, 0
.set vddaout__PRT, CYREG_PRT0_PRT
.set vddaout__PRTDSI__CAPS_SEL, CYREG_PRT0_CAPS_SEL
.set vddaout__PRTDSI__DBL_SYNC_IN, CYREG_PRT0_DBL_SYNC_IN
.set vddaout__PRTDSI__OE_SEL0, CYREG_PRT0_OE_SEL0
.set vddaout__PRTDSI__OE_SEL1, CYREG_PRT0_OE_SEL1
.set vddaout__PRTDSI__OUT_SEL0, CYREG_PRT0_OUT_SEL0
.set vddaout__PRTDSI__OUT_SEL1, CYREG_PRT0_OUT_SEL1
.set vddaout__PRTDSI__SYNC_OUT, CYREG_PRT0_SYNC_OUT
.set vddaout__PS, CYREG_PRT0_PS
.set vddaout__SHIFT, 2
.set vddaout__SLW, CYREG_PRT0_SLW

/* ResistorToVDDA */
.set ResistorToVDDA__0__INTTYPE, CYREG_PICU0_INTTYPE1
.set ResistorToVDDA__0__MASK, 0x02
.set ResistorToVDDA__0__PC, CYREG_PRT0_PC1
.set ResistorToVDDA__0__PORT, 0
.set ResistorToVDDA__0__SHIFT, 1
.set ResistorToVDDA__AG, CYREG_PRT0_AG
.set ResistorToVDDA__AMUX, CYREG_PRT0_AMUX
.set ResistorToVDDA__BIE, CYREG_PRT0_BIE
.set ResistorToVDDA__BIT_MASK, CYREG_PRT0_BIT_MASK
.set ResistorToVDDA__BYP, CYREG_PRT0_BYP
.set ResistorToVDDA__CTL, CYREG_PRT0_CTL
.set ResistorToVDDA__DM0, CYREG_PRT0_DM0
.set ResistorToVDDA__DM1, CYREG_PRT0_DM1
.set ResistorToVDDA__DM2, CYREG_PRT0_DM2
.set ResistorToVDDA__DR, CYREG_PRT0_DR
.set ResistorToVDDA__INP_DIS, CYREG_PRT0_INP_DIS
.set ResistorToVDDA__INTTYPE_BASE, CYDEV_PICU_INTTYPE_PICU0_BASE
.set ResistorToVDDA__LCD_COM_SEG, CYREG_PRT0_LCD_COM_SEG
.set ResistorToVDDA__LCD_EN, CYREG_PRT0_LCD_EN
.set ResistorToVDDA__MASK, 0x02
.set ResistorToVDDA__PORT, 0
.set ResistorToVDDA__PRT, CYREG_PRT0_PRT
.set ResistorToVDDA__PRTDSI__CAPS_SEL, CYREG_PRT0_CAPS_SEL
.set ResistorToVDDA__PRTDSI__DBL_SYNC_IN, CYREG_PRT0_DBL_SYNC_IN
.set ResistorToVDDA__PRTDSI__OE_SEL0, CYREG_PRT0_OE_SEL0
.set ResistorToVDDA__PRTDSI__OE_SEL1, CYREG_PRT0_OE_SEL1
.set ResistorToVDDA__PRTDSI__OUT_SEL0, CYREG_PRT0_OUT_SEL0
.set ResistorToVDDA__PRTDSI__OUT_SEL1, CYREG_PRT0_OUT_SEL1
.set ResistorToVDDA__PRTDSI__SYNC_OUT, CYREG_PRT0_SYNC_OUT
.set ResistorToVDDA__PS, CYREG_PRT0_PS
.set ResistorToVDDA__SHIFT, 1
.set ResistorToVDDA__SLW, CYREG_PRT0_SLW

/* Miscellaneous */
.set BCLK__BUS_CLK__HZ, 24000000
.set BCLK__BUS_CLK__KHZ, 24000
.set BCLK__BUS_CLK__MHZ, 24
.set CYDEV_CHIP_DIE_LEOPARD, 1
.set CYDEV_CHIP_DIE_PSOC4A, 26
.set CYDEV_CHIP_DIE_PSOC5LP, 2
.set CYDEV_CHIP_DIE_PSOC5TM, 3
.set CYDEV_CHIP_DIE_TMA4, 4
.set CYDEV_CHIP_DIE_UNKNOWN, 0
.set CYDEV_CHIP_FAMILY_FM0P, 5
.set CYDEV_CHIP_FAMILY_FM3, 6
.set CYDEV_CHIP_FAMILY_FM4, 7
.set CYDEV_CHIP_FAMILY_PSOC3, 1
.set CYDEV_CHIP_FAMILY_PSOC4, 2
.set CYDEV_CHIP_FAMILY_PSOC5, 3
.set CYDEV_CHIP_FAMILY_PSOC6, 4
.set CYDEV_CHIP_FAMILY_UNKNOWN, 0
.set CYDEV_CHIP_FAMILY_USED, CYDEV_CHIP_FAMILY_PSOC5
.set CYDEV_CHIP_JTAG_ID, 0x2E161069
.set CYDEV_CHIP_MEMBER_3A, 1
.set CYDEV_CHIP_MEMBER_4A, 26
.set CYDEV_CHIP_MEMBER_4AA, 25
.set CYDEV_CHIP_MEMBER_4AB, 30
.set CYDEV_CHIP_MEMBER_4AC, 14
.set CYDEV_CHIP_MEMBER_4AD, 15
.set CYDEV_CHIP_MEMBER_4AE, 16
.set CYDEV_CHIP_MEMBER_4D, 20
.set CYDEV_CHIP_MEMBER_4E, 6
.set CYDEV_CHIP_MEMBER_4F, 27
.set CYDEV_CHIP_MEMBER_4G, 4
.set CYDEV_CHIP_MEMBER_4H, 24
.set CYDEV_CHIP_MEMBER_4I, 32
.set CYDEV_CHIP_MEMBER_4J, 21
.set CYDEV_CHIP_MEMBER_4K, 22
.set CYDEV_CHIP_MEMBER_4L, 31
.set CYDEV_CHIP_MEMBER_4M, 29
.set CYDEV_CHIP_MEMBER_4N, 11
.set CYDEV_CHIP_MEMBER_4O, 8
.set CYDEV_CHIP_MEMBER_4P, 28
.set CYDEV_CHIP_MEMBER_4Q, 17
.set CYDEV_CHIP_MEMBER_4R, 9
.set CYDEV_CHIP_MEMBER_4S, 12
.set CYDEV_CHIP_MEMBER_4T, 10
.set CYDEV_CHIP_MEMBER_4U, 5
.set CYDEV_CHIP_MEMBER_4V, 23
.set CYDEV_CHIP_MEMBER_4W, 13
.set CYDEV_CHIP_MEMBER_4X, 7
.set CYDEV_CHIP_MEMBER_4Y, 18
.set CYDEV_CHIP_MEMBER_4Z, 19
.set CYDEV_CHIP_MEMBER_5A, 3
.set CYDEV_CHIP_MEMBER_5B, 2
.set CYDEV_CHIP_MEMBER_6A, 33
.set CYDEV_CHIP_MEMBER_FM3, 37
.set CYDEV_CHIP_MEMBER_FM4, 38
.set CYDEV_CHIP_MEMBER_PDL_FM0P_TYPE1, 34
.set CYDEV_CHIP_MEMBER_PDL_FM0P_TYPE2, 35
.set CYDEV_CHIP_MEMBER_PDL_FM0P_TYPE3, 36
.set CYDEV_CHIP_MEMBER_UNKNOWN, 0
.set CYDEV_CHIP_MEMBER_USED, CYDEV_CHIP_MEMBER_5B
.set CYDEV_CHIP_DIE_EXPECT, CYDEV_CHIP_MEMBER_USED
.set CYDEV_CHIP_DIE_ACTUAL, CYDEV_CHIP_DIE_EXPECT
.set CYDEV_CHIP_REV_LEOPARD_ES1, 0
.set CYDEV_CHIP_REV_LEOPARD_ES2, 1
.set CYDEV_CHIP_REV_LEOPARD_ES3, 3
.set CYDEV_CHIP_REV_LEOPARD_PRODUCTION, 3
.set CYDEV_CHIP_REV_PSOC4A_ES0, 17
.set CYDEV_CHIP_REV_PSOC4A_PRODUCTION, 17
.set CYDEV_CHIP_REV_PSOC5LP_ES0, 0
.set CYDEV_CHIP_REV_PSOC5LP_PRODUCTION, 0
.set CYDEV_CHIP_REV_PSOC5TM_ES0, 0
.set CYDEV_CHIP_REV_PSOC5TM_ES1, 1
.set CYDEV_CHIP_REV_PSOC5TM_PRODUCTION, 1
.set CYDEV_CHIP_REV_TMA4_ES, 17
.set CYDEV_CHIP_REV_TMA4_ES2, 33
.set CYDEV_CHIP_REV_TMA4_PRODUCTION, 17
.set CYDEV_CHIP_REVISION_3A_ES1, 0
.set CYDEV_CHIP_REVISION_3A_ES2, 1
.set CYDEV_CHIP_REVISION_3A_ES3, 3
.set CYDEV_CHIP_REVISION_3A_PRODUCTION, 3
.set CYDEV_CHIP_REVISION_4A_ES0, 17
.set CYDEV_CHIP_REVISION_4A_PRODUCTION, 17
.set CYDEV_CHIP_REVISION_4AA_PRODUCTION, 0
.set CYDEV_CHIP_REVISION_4AB_PRODUCTION, 0
.set CYDEV_CHIP_REVISION_4AC_PRODUCTION, 0
.set CYDEV_CHIP_REVISION_4AD_PRODUCTION, 0
.set CYDEV_CHIP_REVISION_4AE_PRODUCTION, 0
.set CYDEV_CHIP_REVISION_4D_PRODUCTION, 0
.set CYDEV_CHIP_REVISION_4E_CCG2_NO_USBPD, 0
.set CYDEV_CHIP_REVISION_4E_PRODUCTION, 0
.set CYDEV_CHIP_REVISION_4F_PRODUCTION, 0
.set CYDEV_CHIP_REVISION_4F_PRODUCTION_256DMA, 0
.set CYDEV_CHIP_REVISION_4F_PRODUCTION_256K, 0
.set CYDEV_CHIP_REVISION_4G_ES, 17
.set CYDEV_CHIP_REVISION_4G_ES2, 33
.set CYDEV_CHIP_REVISION_4G_PRODUCTION, 17
.set CYDEV_CHIP_REVISION_4H_PRODUCTION, 0
.set CYDEV_CHIP_REVISION_4I_PRODUCTION, 0
.set CYDEV_CHIP_REVISION_4J_PRODUCTION, 0
.set CYDEV_CHIP_REVISION_4K_PRODUCTION, 0
.set CYDEV_CHIP_REVISION_4L_PRODUCTION, 0
.set CYDEV_CHIP_REVISION_4M_PRODUCTION, 0
.set CYDEV_CHIP_REVISION_4N_PRODUCTION, 0
.set CYDEV_CHIP_REVISION_4O_PRODUCTION, 0
.set CYDEV_CHIP_REVISION_4P_PRODUCTION, 0
.set CYDEV_CHIP_REVISION_4Q_PRODUCTION, 0
.set CYDEV_CHIP_REVISION_4R_PRODUCTION, 0
.set CYDEV_CHIP_REVISION_4S_PRODUCTION, 0
.set CYDEV_CHIP_REVISION_4T_PRODUCTION, 0
.set CYDEV_CHIP_REVISION_4U_PRODUCTION, 0
.set CYDEV_CHIP_REVISION_4V_PRODUCTION, 0
.set CYDEV_CHIP_REVISION_4W_PRODUCTION, 0
.set CYDEV_CHIP_REVISION_4X_PRODUCTION, 0
.set CYDEV_CHIP_REVISION_4Y_PRODUCTION, 0
.set CYDEV_CHIP_REVISION_4Z_PRODUCTION, 0
.set CYDEV_CHIP_REVISION_5A_ES0, 0
.set CYDEV_CHIP_REVISION_5A_ES1, 1
.set CYDEV_CHIP_REVISION_5A_PRODUCTION, 1
.set CYDEV_CHIP_REVISION_5B_ES0, 0
.set CYDEV_CHIP_REVISION_5B_PRODUCTION, 0
.set CYDEV_CHIP_REVISION_6A_ES, 17
.set CYDEV_CHIP_REVISION_6A_NO_UDB, 33
.set CYDEV_CHIP_REVISION_6A_PRODUCTION, 33
.set CYDEV_CHIP_REVISION_FM3_PRODUCTION, 0
.set CYDEV_CHIP_REVISION_FM4_PRODUCTION, 0
.set CYDEV_CHIP_REVISION_PDL_FM0P_TYPE1_PRODUCTION, 0
.set CYDEV_CHIP_REVISION_PDL_FM0P_TYPE2_PRODUCTION, 0
.set CYDEV_CHIP_REVISION_PDL_FM0P_TYPE3_PRODUCTION, 0
.set CYDEV_CHIP_REVISION_USED, CYDEV_CHIP_REVISION_5B_PRODUCTION
.set CYDEV_CHIP_REV_EXPECT, CYDEV_CHIP_REVISION_USED
.set CYDEV_CONFIG_FASTBOOT_ENABLED, 1
.set CYDEV_CONFIG_UNUSED_IO_AllowButWarn, 0
.set CYDEV_CONFIG_UNUSED_IO, CYDEV_CONFIG_UNUSED_IO_AllowButWarn
.set CYDEV_CONFIG_UNUSED_IO_AllowWithInfo, 1
.set CYDEV_CONFIG_UNUSED_IO_Disallowed, 2
.set CYDEV_CONFIGURATION_COMPRESSED, 1
.set CYDEV_CONFIGURATION_DMA, 0
.set CYDEV_CONFIGURATION_ECC, 1
.set CYDEV_CONFIGURATION_IMOENABLED, CYDEV_CONFIG_FASTBOOT_ENABLED
.set CYDEV_CONFIGURATION_MODE_COMPRESSED, 0
.set CYDEV_CONFIGURATION_MODE, CYDEV_CONFIGURATION_MODE_COMPRESSED
.set CYDEV_CONFIGURATION_MODE_DMA, 2
.set CYDEV_CONFIGURATION_MODE_UNCOMPRESSED, 1
.set CYDEV_DEBUG_ENABLE_MASK, 0x20
.set CYDEV_DEBUG_ENABLE_REGISTER, CYREG_MLOGIC_DEBUG
.set CYDEV_DEBUGGING_DPS_Disable, 3
.set CYDEV_DEBUGGING_DPS_JTAG_4, 1
.set CYDEV_DEBUGGING_DPS_JTAG_5, 0
.set CYDEV_DEBUGGING_DPS_SWD, 2
.set CYDEV_DEBUGGING_DPS_SWD_SWV, 6
.set CYDEV_DEBUGGING_DPS, CYDEV_DEBUGGING_DPS_SWD_SWV
.set CYDEV_DEBUGGING_ENABLE, 1
.set CYDEV_DEBUGGING_XRES, 0
.set CYDEV_DMA_CHANNELS_AVAILABLE, 24
.set CYDEV_ECC_ENABLE, 0
.set CYDEV_HEAP_SIZE, 0x80
.set CYDEV_INSTRUCT_CACHE_ENABLED, 1
.set CYDEV_INTR_RISING, 0x00008000
.set CYDEV_IS_EXPORTING_CODE, 0
.set CYDEV_IS_IMPORTING_CODE, 0
.set CYDEV_PROJ_TYPE, 0
.set CYDEV_PROJ_TYPE_BOOTLOADER, 1
.set CYDEV_PROJ_TYPE_LAUNCHER, 5
.set CYDEV_PROJ_TYPE_LOADABLE, 2
.set CYDEV_PROJ_TYPE_LOADABLEANDBOOTLOADER, 4
.set CYDEV_PROJ_TYPE_MULTIAPPBOOTLOADER, 3
.set CYDEV_PROJ_TYPE_STANDARD, 0
.set CYDEV_PROTECTION_ENABLE, 0
.set CYDEV_STACK_SIZE, 0x0800
.set CYDEV_USE_BUNDLED_CMSIS, 1
.set CYDEV_VARIABLE_VDDA, 0
.set CYDEV_VDDA_MV, 5000
.set CYDEV_VDDD_MV, 5000
.set CYDEV_VDDIO0_MV, 5000
.set CYDEV_VDDIO1_MV, 5000
.set CYDEV_VDDIO2_MV, 5000
.set CYDEV_VDDIO3_MV, 5000
.set CYDEV_VIO0_MV, 5000
.set CYDEV_VIO1_MV, 5000
.set CYDEV_VIO2_MV, 5000
.set CYDEV_VIO3_MV, 5000
.set CYIPBLOCK_ARM_CM3_VERSION, 0
.set CYIPBLOCK_P3_ANAIF_VERSION, 0
.set CYIPBLOCK_P3_CAN_VERSION, 0
.set CYIPBLOCK_P3_CAPSENSE_VERSION, 0
.set CYIPBLOCK_P3_COMP_VERSION, 0
.set CYIPBLOCK_P3_DECIMATOR_VERSION, 0
.set CYIPBLOCK_P3_DFB_VERSION, 0
.set CYIPBLOCK_P3_DMA_VERSION, 0
.set CYIPBLOCK_P3_DRQ_VERSION, 0
.set CYIPBLOCK_P3_DSM_VERSION, 0
.set CYIPBLOCK_P3_EMIF_VERSION, 0
.set CYIPBLOCK_P3_I2C_VERSION, 0
.set CYIPBLOCK_P3_LCD_VERSION, 0
.set CYIPBLOCK_P3_LPF_VERSION, 0
.set CYIPBLOCK_P3_OPAMP_VERSION, 0
.set CYIPBLOCK_P3_PM_VERSION, 0
.set CYIPBLOCK_P3_SCCT_VERSION, 0
.set CYIPBLOCK_P3_TIMER_VERSION, 0
.set CYIPBLOCK_P3_USB_VERSION, 0
.set CYIPBLOCK_P3_VIDAC_VERSION, 0
.set CYIPBLOCK_P3_VREF_VERSION, 0
.set CYIPBLOCK_S8_GPIO_VERSION, 0
.set CYIPBLOCK_S8_IRQ_VERSION, 0
.set CYIPBLOCK_S8_SAR_VERSION, 0
.set CYIPBLOCK_S8_SIO_VERSION, 0
.set CYIPBLOCK_S8_UDB_VERSION, 0
.set DMA_CHANNELS_USED__MASK0, 0x00000000
.set CYDEV_BOOTLOADER_ENABLE, 0
.endif
